// MiniGalaxy_Zoom — two LilyGO T-QT Pro boards.
//
// A slow "powers of ten" ride: the view starts on a chunky-pixel Earth and keeps zooming
// out. The Moon swings into view, then the Sun takes the centre and the planets circle it,
// then the Oort cloud, the nearest stars, and finally the whole Milky Way with a dot for
// "you are here". Then it fades to black and starts again. One cycle takes ZOOM_MINUTES.
//
// Both boards run the same cycle in sync (shared clock), each showing a different side of
// the Earth. Bring the boards together at ANY point in the cycle and whatever is on screen
// is torn apart and spirals into ONE black hole sitting in the gap between the screens,
// exactly like MiniGalaxy_Earth. Everything drawn is a particle, so the merge
// works the same for Earth dots, planets, stars and galaxy dots.
//
// The zoom skips quickly through the empty stretches (the dark between Neptune and the
// nearest star) and lingers where there's something to see. Simulated time speeds up with
// the zoom, so the Moon and planets visibly move along their orbits.
//
// How it works: both boards broadcast a small ESP-NOW packet ~40x per second (no router,
// no Wi-Fi network). Each board uses the other's signal strength (RSSI) as a rough distance
// sensor. The packets also carry a shared clock and each board's proximity value.
//
// Flash the SAME sketch to both boards. See README.md for Arduino IDE settings.
// To preview on the PC without flashing: python sim/preview_zoom.py
//
// Buttons:
//   KEY  (right button, IO47) : swap which board is "left" (flips BOTH boards)
//   BOOT (left button,  IO0)  : toggle the debug overlay (signal strength, frames per second
//                               in blue, zoom level in orange, L/R, proximity bar)

#include <Arduino.h>
#include <SPI.h>
#include <WiFi.h>
#include <esp_now.h>
#include <esp_wifi.h>
#include <Preferences.h>
#include "tqt_display.h"
#include "earth_map.h"     // generated by sim/make_earth_map.py

#if !defined(ESP_ARDUINO_VERSION_MAJOR) || ESP_ARDUINO_VERSION_MAJOR < 3
#error "Install 'esp32 by Espressif Systems' version 3.x in Boards Manager (2.x won't work)."
#endif

// ============================ SETTINGS YOU MAY TWEAK ============================

// LilyGO has shipped three different screens on this board: 1, 2 or 3.
#define PANEL_VERSION 3
#define BACKLIGHT_ON LOW
#define FLIP_SCREEN 1

// Signal strength (dBm) where the effect STARTS and where it's at FULL strength.
// Closer to 0 = stronger signal = boards closer. Use the debug overlay (BOOT button)
// to read live values. Touching boards read about -11 to -7.
const float RSSI_FAR        = -20.0f;   // the scenes start leaning toward each other
const float MERGE_START_DBM = -17.0f;   // things start tearing off into the black hole
const float MERGE_FULL_DBM  = -13.0f;   // the black hole is fully formed
const float RSSI_NEAR       = MERGE_FULL_DBM;

// Minimum time (seconds) for the black hole to form, however fast the boards come together.
const float FORM_SECONDS    = 4.0f;

const float MERGE_START = (MERGE_START_DBM - RSSI_FAR) / (RSSI_NEAR - RSSI_FAR);
const float MERGE_FULL  = (MERGE_FULL_DBM  - RSSI_FAR) / (RSSI_NEAR - RSSI_FAR);

// Shared black hole geometry (see MiniGalaxy_Earth).
const float GAP_PX      = 24.0f;
const float HOLE_RADIUS = 44.0f;
const float DISK_TILT   = 0.10f;
const float DISK_INNER  = 1.20f;
const float DISK_OUTER  = 3.40f;
const float REACH_AMP   = 0.60f;
const float STREAM_DIP  = 0.22f;

const wifi_power_t TX_POWER = WIFI_POWER_2dBm;
const uint8_t ESPNOW_CHANNEL = 1;

// ---- the zoom ----
// One full cycle, Earth to Milky Way and fade out, in minutes. Must divide 60 evenly
// (5, 7.5, 10, 12, 15, 20, 30) so both boards' shared clocks agree where the cycle wraps.
const float ZOOM_MINUTES = 7.5f;

// Timeline: at each fraction of the cycle, how wide the screen is (log10 metres) and how fast
// simulated time runs (days per real second). Between keys the zoom is exponential, so every
// tenfold step inside a segment takes the same time. The zoom rate is the same everywhere
// (about 34 s per tenfold step at 7.5 min) except the empty stretch between Neptune and the
// nearest stars, which goes 1.6x faster. Add, move or remove rows freely.
struct ZoomKey { float phase, logW, dayRate; };
static const ZoomKey ZOOM_KEYS[] = {
  {0.000f,  7.14f,    0.02f},   // Earth fills the screen (fades in from black)...
  {0.022f,  7.14f,    0.02f},   // ...and holds for 10 s, then the zoom starts
  {0.164f,  9.05f,    0.12f},   // the Moon's orbit fits on screen
  {0.373f, 11.85f,    2.50f},   // inner solar system: the Sun takes the centre, Mars' orbit fits
  {0.473f, 13.20f,   20.00f},   // out past Neptune
  {0.585f, 15.60f,  150.00f},   // the Oort cloud (the fast stretch)
  {0.618f, 16.30f,  400.00f},   // ...back to normal speed as the stars appear
  {0.744f, 18.00f, 1500.00f},   // the nearest hundred light-years of stars
  {0.967f, 21.00f, 1500.00f},   // the whole Milky Way; a short hold while it fades
  {1.000f, 21.00f, 1500.00f},
};
const float FADE_IN_END   = 0.020f;  // cycle fractions: fade in from black...
const float FADE_OUT_BEG  = 0.955f;  // ...and out to black at the end
const float FADE_OUT_END  = 0.985f;

const float VIEW_TILT = 0.50f;       // orbits are seen at a slant: 1 = face on, 0 = edge on
const float AXIAL_TILT = 0.42f;      // Earth's lean on screen, north pole toward you

// Earth dot globe (used while the Earth is bigger than ~20 px; smaller Earths are drawn solid)
const int   RINGS     = 36;          // latitude rows of dots (36 rings = ~1650 dots)
const int   NUM_STARS = 70;          // faint far-background stars that twinkle

// Simple palette: two blues for the sea, three greens for the land.
static const float SEA_DEEP[3]    = {0.03f, 0.10f, 0.38f};
static const float SEA_SHALLOW[3] = {0.10f, 0.34f, 0.72f};
static const float LAND_DARK[3]   = {0.08f, 0.38f, 0.10f};
static const float LAND_MID[3]    = {0.22f, 0.58f, 0.14f};
static const float LAND_LIGHT[3]  = {0.48f, 0.76f, 0.24f};
static const float *const EARTH_PAL[16] = {
  SEA_DEEP, SEA_DEEP, SEA_SHALLOW, LAND_LIGHT, LAND_MID, LAND_DARK, LAND_DARK, LAND_MID,
  LAND_LIGHT, LAND_MID, LAND_DARK, LAND_MID, SEA_DEEP, SEA_DEEP, SEA_DEEP, SEA_DEEP,
};

// ---- the solar system (real sizes, circular orbits) ----
const float AU = 1.496e11f;          // metres
const float LY = 9.461e15f;
struct Planet { float a; float period; float radius; float r, g, b; float phase0; };
static const Planet PLANETS[] = {   // orbit radius (m), period (days), body radius (m), colour, start angle
  {0.387f * AU,    87.97f, 2.44e6f,  0.62f, 0.60f, 0.56f, 1.3f},   // Mercury
  {0.723f * AU,   224.70f, 6.05e6f,  0.95f, 0.86f, 0.62f, 3.1f},   // Venus
  {1.000f * AU,   365.25f, 6.371e6f, 0.30f, 0.55f, 1.00f, 1.20f},  // Earth (the one we start on)
  {1.524f * AU,   687.00f, 3.39e6f,  0.90f, 0.45f, 0.25f, 5.0f},   // Mars
  {5.203f * AU,  4332.60f, 6.99e7f,  0.85f, 0.72f, 0.52f, 0.6f},   // Jupiter
  {9.537f * AU, 10759.00f, 5.82e7f,  0.90f, 0.82f, 0.58f, 2.2f},   // Saturn
  {19.19f * AU, 30687.00f, 2.54e7f,  0.62f, 0.85f, 0.90f, 4.1f},   // Uranus
  {30.07f * AU, 60190.00f, 2.46e7f,  0.35f, 0.45f, 0.95f, 5.6f},   // Neptune
};
const int EARTH_IX = 2;
const float SUN_RADIUS = 6.96e8f;
const float MOON_A = 3.844e8f, MOON_PERIOD = 27.32f, MOON_RADIUS = 1.737e6f;
const float GAL_CENTER_LY = 26000.0f;                 // the Sun's distance from the galactic centre
const float GAL_DIR_X = -0.55f, GAL_DIR_Y = 0.835f;   // which way the centre lies on screen
const int   N_GALAXY = 1400, N_NEAR = 350, N_OORT = 300;

// ================================================================================

constexpr int W = tqt::W, H = tqt::H;
static uint16_t fb[W * H];           // framebuffer, byte-swapped RGB565

const int PIN_BTN_BOOT = 0;
const int PIN_BTN_KEY  = 47;

// ---------- the Earth dot globe ----------
struct Dot {
  float x, y, z;           // unit-sphere position
  uint8_t land;            // surface class under this dot
  uint8_t u, a;            // its slot in the accretion disk (radius, angle), from latitude/longitude
};
const int MAX_DOTS = 1700;
static Dot dots[MAX_DOTS];
static int numDots = 0;

struct Star { float x, y, b; };
static Star stars[NUM_STARS];

// ---------- particles: everything drawn in a frame ----------
// Each frame the scene is "emitted" as a list of coloured squares. With the boards apart they
// are simply drawn; while merging, each one spirals into the black hole from where it is.
struct Part { int16_t x, y; uint16_t c; uint8_t size, u, a, fl; };
enum { PF_BACK = 1, PF_EARTH = 2, PF_OTHER = 4, PF_FRONT = 8 };
const int MAX_PART = 4000;
static Part parts[MAX_PART];
static int  nParts = 0;
static float cullX0 = -3.0f, cullX1 = W + 2.0f;   // where this copy of the scene is visible
static bool  cullAll = false;                     // merging: keep everything, it may stream in

// ---------- baked star fields ----------
struct GalDot  { int16_t x, y; uint8_t type; };   // position in 100 ly, from the galactic centre
struct NearStar { int16_t x, y; uint8_t bright, type; };   // position in 0.5 ly, from the Sun
static GalDot   galaxy[N_GALAXY];
static NearStar nearStars[N_NEAR];

// where we are in the zoom this frame
struct ZoomState {
  float logW, ppm, env, days;
  float pulse;                 // slow blink for the "you are here" marker
  float earthX, earthY;        // Earth's position round the Sun (m)
  float camX, camY;            // where the camera looks, relative to the Earth (m)
};

static uint8_t  glowMap[W * H];      // precomputed soft glow behind the black hole (this board's half)
static float    glowBuiltFor = 0.0f;
static uint16_t glowLut[256];
static float    dayTab[257];         // simulated days elapsed at each 1/256 of the cycle

// ---------- radio link ----------
struct __attribute__((packed)) Packet {
  uint32_t magic;
  uint8_t  version;
  uint8_t  swapCount;
  uint16_t seq;
  uint32_t clockMs;      // sender's shared clock
  uint8_t  prox;         // sender's proximity 0..255
};
const uint32_t MAGIC = 0x50535154;   // "TQSP"
const uint8_t  PROTO = 2;
const uint8_t  BCAST[6] = {0xFF, 0xFF, 0xFF, 0xFF, 0xFF, 0xFF};

static portMUX_TYPE linkMux = portMUX_INITIALIZER_UNLOCKED;
const int RSSI_BUF = 8;
static volatile int8_t   rssiBuf[RSSI_BUF];
static volatile uint32_t rssiCount = 0;
static volatile uint32_t lastRxMs = 0;
static volatile uint8_t  peerSwap = 0;
static volatile uint8_t  peerProxByte = 0;
static volatile uint32_t peerClockMs = 0;
static volatile uint32_t peerClockRxMs = 0;
static uint8_t peerMac[6] = {0};
static uint8_t myMac[6]   = {0};

static uint8_t  mySwap = 0;
static uint16_t txSeq = 0;
static Preferences prefs;
static int32_t  clockOffset = 0;     // shared clock = millis() + clockOffset
static bool     clockSynced = false;

// ---------- animation state ----------
static float rssiFiltered = -100.0f;
static float prox = 0.0f;            // this board's own proximity estimate, 0..1
static float sceneP = 0.0f;          // proximity used for drawing (averaged with the peer's)
static float sideSmooth = 1.0f;      // +1 = I'm the LEFT board (peer on my right), -1 = right board
static float spinExtra = 0.0f;       // extra Earth spin that builds up while close
static float curLogW = 7.0f;         // for the debug overlay
static float curPpm = 1.0f, curEnv = 1.0f;   // for the scale bar
static bool  showDebug = false;

// =================================== helpers ===================================

static inline float clampf(float v, float lo, float hi) { return v < lo ? lo : (v > hi ? hi : v); }

static inline float smoothstepf(float a, float b, float x) {
  float t = clampf((x - a) / (b - a), 0.0f, 1.0f);
  return t * t * (3.0f - 2.0f * t);
}

static inline uint16_t rgb565(uint8_t r, uint8_t g, uint8_t b) {
  uint16_t c = ((r & 0xF8) << 8) | ((g & 0xFC) << 3) | (b >> 3);
  return (uint16_t)((c << 8) | (c >> 8));  // byte-swap for the SPI push
}

static inline uint16_t pack(float r, float g, float b) {
  return rgb565((uint8_t)(clampf(r, 0, 1) * 255), (uint8_t)(clampf(g, 0, 1) * 255), (uint8_t)(clampf(b, 0, 1) * 255));
}

static inline void unpack(uint16_t c, float &r, float &g, float &b) {
  c = (uint16_t)((c << 8) | (c >> 8));
  r = ((c >> 11) & 31) / 31.0f; g = ((c >> 5) & 63) / 63.0f; b = (c & 31) / 31.0f;
}

// fraction of a turn (any real number) -> 0..65535
static inline uint16_t turn16(float f) { f -= floorf(f); return (uint16_t)(f * 65536.0f); }

// Disk palette: 0 = inner edge (white-hot) -> 1 = outer edge (deep orange)
static void diskColor(float k, float &r, float &g, float &b) {
  k = clampf(k, 0.0f, 1.0f);
  if (k < 0.30f)      { float t = k / 0.30f;            r = 1.0f;               g = 1.0f - 0.08f * t;  b = 1.0f - 0.30f * t; }
  else if (k < 0.65f) { float t = (k - 0.30f) / 0.35f;  r = 1.0f;               g = 0.92f - 0.32f * t; b = 0.70f - 0.45f * t; }
  else                { float t = (k - 0.65f) / 0.35f;  r = 1.0f - 0.25f * t;   g = 0.60f - 0.32f * t; b = 0.25f - 0.18f * t; }
}

static inline void plot(int x, int y, uint16_t c) {
  if ((unsigned)x >= (unsigned)W || (unsigned)y >= (unsigned)H) return;
#if FLIP_SCREEN
  x = W - 1 - x; y = H - 1 - y;
#endif
  fb[y * W + x] = c;
}

static inline void fillRect(int x, int y, int w, int h, uint16_t c) {
  int x0 = x < 0 ? 0 : x, y0 = y < 0 ? 0 : y;    // clip once, then write rows directly
  int x1 = x + w > W ? W : x + w, y1 = y + h > H ? H : y + h;
  if (x0 >= x1 || y0 >= y1) return;
  for (int yy = y0; yy < y1; yy++) {
#if FLIP_SCREEN
    uint16_t *p = &fb[(H - 1 - yy) * W + (W - x1)];
#else
    uint16_t *p = &fb[yy * W + x0];
#endif
    for (int n = x1 - x0; n > 0; n--) *p++ = c;
  }
}

static void fillCircle(float cx, float cy, float rad, uint16_t c) {
  int r = (int)ceilf(rad);
  float r2 = rad * rad;
  int x0 = (int)floorf(cx), y0 = (int)floorf(cy);
  for (int y = -r; y <= r; y++) {
    int yy = y0 + y;
    if (yy < 0 || yy >= H) continue;
    for (int x = -r; x <= r; x++) {
      int xx = x0 + x;
      if (xx < 0 || xx >= W) continue;
      float dx = xx + 0.5f - cx, dy = yy + 0.5f - cy;
      if (dx * dx + dy * dy <= r2) plot(xx, yy, c);
    }
  }
}

static float hash01(uint32_t n) {                      // cheap repeatable pseudo-random 0..1
  n = (n ^ 61) ^ (n >> 16); n *= 9; n ^= n >> 4; n *= 0x27d4eb2d; n ^= n >> 15;
  return (n & 0xFFFFFF) / 16777216.0f;
}

// 3x5 pixel font: digits, then - L R . A K M U Y
static const uint8_t FONT3x5[][5] = {
  {7,5,5,5,7}, {2,6,2,2,7}, {7,1,7,4,7}, {7,1,7,1,7}, {5,5,7,1,1},
  {7,4,7,1,7}, {7,4,7,5,7}, {7,1,1,1,1}, {7,5,7,5,7}, {7,5,7,1,7},
  {0,0,7,0,0}, {4,4,4,4,7}, {6,5,6,5,5}, {0,0,0,0,2},
  {2,5,7,5,5}, {5,5,6,5,5}, {5,7,7,5,5}, {5,5,5,5,7}, {5,5,2,2,2},
};
static void drawChar(int x, int y, char ch, uint16_t c, int s) {
  int idx;
  if (ch >= '0' && ch <= '9') idx = ch - '0';
  else if (ch == '-') idx = 10;
  else if (ch == 'L') idx = 11;
  else if (ch == 'R') idx = 12;
  else if (ch == '.') idx = 13;
  else if (ch == 'A') idx = 14;
  else if (ch == 'K') idx = 15;
  else if (ch == 'M') idx = 16;
  else if (ch == 'U') idx = 17;
  else if (ch == 'Y') idx = 18;
  else return;
  for (int row = 0; row < 5; row++)
    for (int col = 0; col < 3; col++)
      if (FONT3x5[idx][row] & (4 >> col)) fillRect(x + col * s, y + row * s, s, s, c);
}
static void drawText(int x, int y, const char *str, uint16_t c, int s) {
  for (; *str; str++, x += 4 * s) drawChar(x, y, *str, c, s);
}

// ================================= radio link ==================================

static void onRecv(const esp_now_recv_info_t *info, const uint8_t *data, int len) {
  if (len != (int)sizeof(Packet)) return;
  Packet p;
  memcpy(&p, data, sizeof(p));
  if (p.magic != MAGIC || p.version != PROTO) return;
  uint32_t now = millis();
  portENTER_CRITICAL(&linkMux);
  memcpy(peerMac, info->src_addr, 6);
  rssiBuf[rssiCount % RSSI_BUF] = (int8_t)info->rx_ctrl->rssi;
  rssiCount = rssiCount + 1;
  lastRxMs = now;
  peerSwap = p.swapCount;
  peerProxByte = p.prox;
  peerClockMs = p.clockMs;
  peerClockRxMs = now;
  portEXIT_CRITICAL(&linkMux);
}

static void radioBegin() {
  WiFi.mode(WIFI_STA);
  WiFi.disconnect();
  WiFi.setTxPower(TX_POWER);
  esp_wifi_set_promiscuous(true);
  esp_wifi_set_channel(ESPNOW_CHANNEL, WIFI_SECOND_CHAN_NONE);
  esp_wifi_set_promiscuous(false);
  esp_wifi_get_mac(WIFI_IF_STA, myMac);

  if (esp_now_init() != ESP_OK) {
    Serial.println("ESP-NOW init failed");
    return;
  }
  esp_now_register_recv_cb(onRecv);

  esp_now_peer_info_t peer = {};
  memcpy(peer.peer_addr, BCAST, 6);
  peer.channel = 0;                  // 0 = current channel
  peer.ifidx = WIFI_IF_STA;
  peer.encrypt = false;
  esp_now_add_peer(&peer);
}

static inline uint32_t sharedMillis() { return millis() + (uint32_t)clockOffset; }

static void radioSend() {
  Packet p;
  p.magic = MAGIC;
  p.version = PROTO;
  p.swapCount = mySwap;
  p.seq = txSeq++;
  p.clockMs = sharedMillis();
  p.prox = (uint8_t)(clampf(prox, 0, 1) * 255.0f);
  esp_now_send(BCAST, (const uint8_t *)&p, sizeof(p));
}

// Median of the most recent RSSI samples (kills single-packet spikes)
static float rssiMedian() {
  int8_t s[RSSI_BUF];
  int n;
  portENTER_CRITICAL(&linkMux);
  n = rssiCount < RSSI_BUF ? (int)rssiCount : RSSI_BUF;
  for (int i = 0; i < n; i++) s[i] = rssiBuf[i];
  portEXIT_CRITICAL(&linkMux);
  if (n == 0) return -100;
  for (int i = 1; i < n; i++) {      // insertion sort, n <= 8
    int8_t v = s[i]; int j = i - 1;
    while (j >= 0 && s[j] > v) { s[j + 1] = s[j]; j--; }
    s[j + 1] = v;
  }
  return s[n / 2];
}

// ================================ the timeline =================================

// Screen width (log10 m) and simulated-time rate at a point in the cycle.
static void zoomAt(float phase, float &logW, float &rate) {
  const int n = sizeof(ZOOM_KEYS) / sizeof(ZOOM_KEYS[0]);
  phase = clampf(phase, 0.0f, 1.0f);
  int i = 0;
  while (i < n - 2 && phase >= ZOOM_KEYS[i + 1].phase) i++;
  const ZoomKey &k0 = ZOOM_KEYS[i], &k1 = ZOOM_KEYS[i + 1];
  float f = clampf((phase - k0.phase) / (k1.phase - k0.phase), 0.0f, 1.0f);
  logW = k0.logW + (k1.logW - k0.logW) * f;
  rate = expf(logf(k0.dayRate) + (logf(k1.dayRate) - logf(k0.dayRate)) * f);
}

static void buildDayTable() {
  const float cycleS = ZOOM_MINUTES * 60.0f;
  float cum = 0.0f, lw, r0, r1;
  dayTab[0] = 0.0f;
  zoomAt(0.0f, lw, r0);
  for (int k = 1; k <= 256; k++) {
    zoomAt(k / 256.0f, lw, r1);
    cum += 0.5f * (r0 + r1) * (cycleS / 256.0f);
    dayTab[k] = cum;
    r0 = r1;
  }
}

static float simDaysAt(float phase) {
  float f = clampf(phase, 0.0f, 1.0f) * 256.0f;
  int k = (int)f; if (k > 255) k = 255;
  return dayTab[k] + (dayTab[k + 1] - dayTab[k]) * (f - k);
}

// ================================== building ===================================

static void buildScene() {
  numDots = 0;
  for (int r = 0; r < RINGS && numDots < MAX_DOTS; r++) {
    float lat = PI * ((r + 0.5f) / RINGS) - HALF_PI;     // -90..90 deg
    float cl = cosf(lat), sl = sinf(lat);
    int count = max(1, (int)roundf(2.0f * RINGS * cl));
    for (int k = 0; k < count && numDots < MAX_DOTS; k++) {
      float lon = TWO_PI * (k + 0.5f * (r & 1)) / count;
      Dot &d = dots[numDots];
      d.x = cl * cosf(lon);
      d.y = sl;
      d.z = cl * sinf(lon);
      uint16_t tu = turn16(0.5f - lon / TWO_PI);
      uint8_t  tv = (uint8_t)clampf((0.5f - lat / PI) * EARTH_TH, 0, EARTH_TH - 1);
      d.land = EARTH_LAND[tv][tu >> 8] & 15;
      // Disk slot from where the dot sits on the globe, so neighbours stay neighbours as they
      // fall in: the equator feeds the hot inner edge, the poles spread to the outer rim.
      float u = powf(1.0f - cl, 0.55f) + 0.05f * (hash01(numDots * 2 + 1) - 0.5f);
      d.u = (uint8_t)(clampf(u, 0.0f, 1.0f) * 255.0f);
      d.a = (uint8_t)(lon / TWO_PI * 255.0f);
      numDots++;
    }
  }
  for (int i = 0; i < NUM_STARS; i++) {
    stars[i].x = hash01(i * 3 + 101) * W;
    stars[i].y = hash01(i * 3 + 202) * H;
    stars[i].b = 0.15f + 0.45f * hash01(i * 3 + 303);
  }
  // the Milky Way: a yellow bulge, two bluish arms and scattered disc stars (in light-years)
  for (int i = 0; i < N_GALAXY; i++) {
    float h1 = hash01(i * 7 + 11), h2 = hash01(i * 7 + 13), h3 = hash01(i * 7 + 17), h4 = hash01(i * 7 + 19);
    float r, th; uint8_t type;
    if ((i & 3) == 0) {                                   // bulge
      r = 4500.0f * sqrtf(h1); th = h2 * TWO_PI; type = 0;
    } else {
      r = 1500.0f + 48500.0f * powf(h1, 0.65f);
      float arm = (i & 1) ? PI : 0.0f;
      th = arm + 3.6f * logf(r / 1500.0f) + (h2 + h3 - 1.0f) * 0.45f;
      type = 1;
      if ((i % 3) == 2) { th += (h4 - 0.5f) * 2.5f; type = 2; }   // loose disc star
    }
    galaxy[i].x = (int16_t)(r * cosf(th) / 100.0f);
    galaxy[i].y = (int16_t)(r * sinf(th) / 100.0f);
    galaxy[i].type = type;
  }
  // the nearest stars as the eye sees them: mostly white, some blue-white, a few dim red dwarfs
  for (int i = 0; i < N_NEAR; i++) {
    float h1 = hash01(i * 5 + 23), h2 = hash01(i * 5 + 29), h3 = hash01(i * 5 + 31);
    float r = 150.0f * sqrtf(h1), th = h2 * TWO_PI;
    nearStars[i].x = (int16_t)(r * cosf(th) * 2.0f);
    nearStars[i].y = (int16_t)(r * sinf(th) * 2.0f);
    if (h3 < 0.30f)      { nearStars[i].type = 0; nearStars[i].bright = (uint8_t)(60 + 50 * hash01(i * 5 + 37)); }
    else if (h3 < 0.85f) { nearStars[i].type = 1; nearStars[i].bright = (uint8_t)(120 + 100 * hash01(i * 5 + 37)); }
    else                 { nearStars[i].type = 2; nearStars[i].bright = (uint8_t)(200 + 55 * hash01(i * 5 + 37)); }
  }
}

// Hole centre in THIS board's screen coordinates. The left board's screen spans virtual
// x = 0..127, then GAP_PX of bezel, then the right board's screen. The hole sits in the gap.
static inline float holeCenterX(float sideSign) { return W * 0.5f + sideSign * (W * 0.5f + GAP_PX * 0.5f); }

static void buildGlow(float sideSign) {
  float hcx = holeCenterX(sideSign), hcy = H * 0.5f;
  float ct = cosf(DISK_TILT), st = sinf(DISK_TILT);
  for (int y = 0; y < H; y++) {
    for (int x = 0; x < W; x++) {
      float dx = x + 0.5f - hcx, dy = hcy - (y + 0.5f);  // dy up
      float ux =  dx * ct + dy * st;                     // un-tilt so the band follows the disk
      float uy = -dx * st + dy * ct;
      float r = sqrtf(dx * dx + dy * dy);
      float g = 0.0f;
      if (r > HOLE_RADIUS) {
        float band = expf(-fabsf(uy) / (5.0f + 0.07f * fabsf(ux))) * expf(-fabsf(ux) / 150.0f);
        float ring = expf(-fabsf(r - HOLE_RADIUS * 1.22f) / 10.0f);
        float haze = expf(-(r - HOLE_RADIUS) / 60.0f);
        g = 0.55f * band + 0.40f * ring + 0.25f * haze;
      }
      glowMap[y * W + x] = (uint8_t)(clampf(g, 0, 1) * 255.0f);
    }
  }
  glowBuiltFor = sideSign;
}

// ================================== emitters ===================================
// Each emitter adds coloured squares to the particle list. (x, y) is the square's top-left.

static inline void addPart(float x, float y, uint16_t c, int size, int u, int a, int fl, bool mayPoke = false) {
  if (nParts >= MAX_PART) return;
  if (!cullAll) {
    float x0 = mayPoke ? -3.0f : cullX0, x1 = mayPoke ? W + 2.0f : cullX1;
    if (x < x0 || x > x1 || y < -3.0f || y > H + 2.0f) return;
  } else if (x < -3 * W || x > 4 * W || y < -3 * H || y > 4 * H) return;
  Part &p = parts[nParts++];
  p.x = (int16_t)floorf(x); p.y = (int16_t)floorf(y); p.c = c;
  p.size = (uint8_t)size; p.u = (uint8_t)u; p.a = (uint8_t)a; p.fl = (uint8_t)fl;
}

// The big Earth as a globe of chunky dots, optionally stretched toward the other board.
// sizeF is the dot size as a real number: dots switch between the two nearest whole sizes one
// by one (by hash) as it changes, so the globe shrinks without visible steps.
static void emitEarthDots(float cx, float cy, float R, float sphere, float spin, float reachAmt,
                          float lx, float ly, float lz, float sizeF, float env, bool other, bool withBack) {
  const float cR = cosf(spin), sR = sinf(spin);
  const float cT = cosf(AXIAL_TILT), sT = sinf(AXIAL_TILT);
  const int fl0 = PF_EARTH | (other ? PF_OTHER : 0);
  const int aOff = other ? 128 : 0;
  const int   baseSize = (int)floorf(sizeF);
  const float frac = sizeF - baseSize;
  for (int i = 0; i < numDots; i++) {
    const Dot &d = dots[i];
    const int dotSize = baseSize + (hash01(i * 7 + 99) < frac ? 1 : 0);
    const int off = dotSize / 2;
    float x1 = d.x * cR + d.z * sR;
    float z1 = -d.x * sR + d.z * cR;
    float sy = d.y * cT - z1 * sT;
    float sz = d.y * sT + z1 * cT;
    float sx = x1;
    const float nx = sx, ny = sy, nz = sz;         // surface normal before stretching, for lighting
    bool sFront = sz >= 0;
    if (!sFront && !withBack) continue;            // the globe is opaque: no far side
    float dp = sx * sphere;                        // +1 = facing the other board
    float reach = dp > 0 ? dp * dp * dp : 0.0f;
    float back  = dp < 0 ? -dp : 0.0f;
    float r = 1.0f + reachAmt * (REACH_AMP * reach - 0.10f * back);
    float pinch = 1.0f - 0.30f * reachAmt * reach;
    sx *= r; sy *= r * pinch; sz *= r * pinch;
    float persp = 3.4f / (3.4f - sz);
    float spx = cx + sx * R * persp;
    float spy = cy - sy * R * persp;
    float lit = (0.30f + 0.70f * clampf(nx * lx + ny * ly + nz * lz, 0.0f, 1.0f)) * env;
    const float *c = EARTH_PAL[d.land];
    addPart(spx - off, spy - off, pack(c[0] * lit, c[1] * lit, c[2] * lit), dotSize,
            d.u, (d.a + aOff) & 255, fl0 | (sFront ? 0 : PF_BACK), true);
  }
}

// A small Earth, drawn solid pixel by pixel with the same map and lighting.
static void emitMiniGlobe(float cx, float cy, float rad, float spin, float lx, float ly, float lz,
                          float env, bool other) {
  const float cR = cosf(spin), sR = sinf(spin);
  const float cT = cosf(AXIAL_TILT), sT = sinf(AXIAL_TILT);
  const int fl0 = PF_EARTH | (other ? PF_OTHER : 0);
  const int aOff = other ? 128 : 0;
  int x0 = (int)floorf(cx - rad), x1 = (int)ceilf(cx + rad);
  int y0 = (int)floorf(cy - rad), y1 = (int)ceilf(cy + rad);
  for (int py = y0; py <= y1; py++) {
    for (int px = x0; px <= x1; px++) {
      float nx = (px + 0.5f - cx) / rad, ny = (cy - (py + 0.5f)) / rad;
      float d2 = nx * nx + ny * ny;
      if (d2 > 1.0f) continue;
      float nz = sqrtf(1.0f - d2);
      float ey = ny * cT + nz * sT;                  // undo the axial tilt...
      float z1 = -ny * sT + nz * cT;
      float ex = nx * cR - z1 * sR;                  // ...and the spin
      float ez = nx * sR + z1 * cR;
      float lon = atan2f(ez, ex);
      float lat = asinf(clampf(ey, -1.0f, 1.0f));
      uint16_t tu = turn16(0.5f - lon / TWO_PI);
      uint8_t  tv = (uint8_t)clampf((0.5f - lat / PI) * EARTH_TH, 0, EARTH_TH - 1);
      const float *c = EARTH_PAL[EARTH_LAND[tv][tu >> 8] & 15];
      float lit = (0.30f + 0.70f * clampf(nx * lx + ny * ly + nz * lz, 0.0f, 1.0f)) * env;
      int u = (int)(sqrtf(1.0f - cosf(lat)) * 255.0f);
      int a = ((int)(tu >> 8) + aOff) & 255;
      addPart(px, py, pack(c[0] * lit, c[1] * lit, c[2] * lit), 1, u, a, fl0, true);
    }
  }
}

// A plain lit disc (planets, the Moon). id keeps its disk slots stable between frames.
static void emitDisc(float cx, float cy, float rad, float cr, float cg, float cb,
                     float lx, float ly, float lz, float env, int id, bool other) {
  if (rad > 40.0f) rad = 40.0f;
  const int fl0 = other ? PF_OTHER : 0;
  int x0 = (int)floorf(cx - rad), x1 = (int)ceilf(cx + rad);
  int y0 = (int)floorf(cy - rad), y1 = (int)ceilf(cy + rad);
  if (x1 < cullX0 - W || x0 > cullX1 + W) return;
  for (int py = y0; py <= y1; py++) {
    for (int px = x0; px <= x1; px++) {
      float nx = (px + 0.5f - cx) / rad, ny = (cy - (py + 0.5f)) / rad;
      float d2 = nx * nx + ny * ny;
      if (d2 > 1.0f) continue;
      float nz = sqrtf(1.0f - d2);
      float lit = (0.18f + 0.82f * clampf(nx * lx + ny * ly + nz * lz, 0.0f, 1.0f)) * env;
      uint32_t h = (uint32_t)(id * 7919 + (px - x0) * 131 + (py - y0));
      addPart(px, py, pack(cr * lit, cg * lit, cb * lit), 1,
              (int)(hash01(h) * 255), (int)(hash01(h + 17) * 255), fl0);
    }
  }
}

static inline void emitPixel(float x, float y, float r, float g, float b, int id, bool other) {
  addPart(floorf(x), floorf(y), pack(r, g, b), 1, (int)(hash01(id * 13 + 5) * 255),
          (int)(hash01(id * 13 + 9) * 255), other ? PF_OTHER : 0);
}

// A body too small to draw properly: a 2x2 block, so planets stay visible among 1-px stars.
static inline void emitBody(float x, float y, float r, float g, float b, int id, bool other) {
  addPart(floorf(x - 0.5f), floorf(y - 0.5f), pack(r, g, b), 2, (int)(hash01(id * 13 + 5) * 255),
          (int)(hash01(id * 13 + 9) * 255), other ? PF_OTHER : 0);
}

// A faint dotted ellipse: an orbit seen at the view tilt.
static void emitRing(float cx, float cy, float ra, float alpha, int id, bool other) {
  if (alpha <= 0.01f) return;
  if (cx + ra < cullX0 - 2 || cx - ra > cullX1 + 2) return;
  int n = (int)clampf(ra * 0.9f, 16.0f, 120.0f);
  const float cr = 0.35f * alpha, cg = 0.42f * alpha, cb = 0.55f * alpha;
  for (int k = 0; k < n; k++) {
    float th = TWO_PI * k / n;
    emitPixel(cx + ra * cosf(th), cy - ra * sinf(th) * VIEW_TILT, cr, cg, cb, id * 256 + k, other);
  }
}

// The Sun: a white-yellow core (its real size, usually under a pixel) with a soft bloom.
static void emitSun(float cx, float cy, float rs, float rb, float env, bool other) {
  float ext = rb * 2.2f + 2.0f;
  if (cx + ext < cullX0 - 2 || cx - ext > cullX1 + 2 || cy + ext < -3 || cy - ext > H + 2) return;
  int x0 = (int)floorf(cx - ext), x1 = (int)ceilf(cx + ext);
  int y0 = (int)floorf(cy - ext), y1 = (int)ceilf(cy + ext);
  for (int py = y0; py <= y1; py++) {
    for (int px = x0; px <= x1; px++) {
      float dx = px + 0.5f - cx, dy = py + 0.5f - cy;
      float d = sqrtf(dx * dx + dy * dy);
      float v = d <= rs ? 1.0f : expf(-(d - rs) / (0.55f * rb));
      if (v < 0.06f) continue;
      v *= env;
      emitPixel(px, py, v, v * 0.93f, v * 0.70f, 900000 + (px - x0) * 97 + (py - y0), other);
    }
  }
}

// -------------------------------- the whole scene -------------------------------

// Emit one copy of the scene centred on (ox, oy). sphere = +1 for the left-hand copy.
static void emitScene(const ZoomState &z, float ox, float oy, float sphere, float spin, float reachAmt,
                      bool other, bool withBack) {
  const float ppm = z.ppm, env = z.env, logW = z.logW;
  const float VT = VIEW_TILT, CT = sqrtf(1.0f - VIEW_TILT * VIEW_TILT);
  // everything is positioned relative to the Earth, then the camera offset is taken away
  auto scrX = [&](float relX) { return ox + (relX - z.camX) * ppm; };
  auto scrY = [&](float relY) { return oy - (relY - z.camY) * ppm * VT; };
  const float sunRelX = -z.earthX, sunRelY = -z.earthY;
  const float sunSx = scrX(sunRelX), sunSy = scrY(sunRelY);

  // --- the Milky Way ---
  float galA = smoothstepf(18.8f, 20.2f, logW);
  if (galA > 0.0f) {
    const float gcx = sunRelX + GAL_CENTER_LY * LY * GAL_DIR_X, gcy = sunRelY + GAL_CENTER_LY * LY * GAL_DIR_Y;
    for (int i = 0; i < N_GALAXY; i++) {
      const GalDot &g = galaxy[i];
      float rx = gcx + g.x * (100.0f * LY), ry = gcy + g.y * (100.0f * LY);
      float dist = sqrtf((float)g.x * g.x + (float)g.y * g.y) / 500.0f;   // 0 centre .. 1 rim
      float b = (1.0f - 0.55f * dist) * galA * env;
      float r, gg, bb;
      if (g.type == 0)      { r = 1.00f * b; gg = 0.88f * b; bb = 0.68f * b; }
      else if (g.type == 1) { r = 0.70f * b * 0.8f; gg = 0.80f * b * 0.8f; bb = 1.00f * b * 0.8f; }
      else                  { r = 0.85f * b * 0.5f; gg = 0.85f * b * 0.5f; bb = 0.80f * b * 0.5f; }
      emitPixel(scrX(rx), scrY(ry), r, gg, bb, 100000 + i, other);
    }
  }
  // --- the nearest stars ---
  float nearA = smoothstepf(15.3f, 16.3f, logW) * (1.0f - smoothstepf(19.3f, 20.3f, logW));
  if (nearA > 0.0f) {
    for (int i = 0; i < N_NEAR; i++) {
      const NearStar &s = nearStars[i];
      float sx = scrX(sunRelX + s.x * (0.5f * LY)), sy = scrY(sunRelY + s.y * (0.5f * LY));
      if (fabsf(sx - sunSx) < 1.5f && fabsf(sy - sunSy) < 1.5f) continue;   // inside the Sun's pixel
      float b = s.bright / 255.0f * nearA * env;
      if (s.type == 0)      emitPixel(sx, sy, b, b * 0.38f, b * 0.25f, 200000 + i, other);   // red dwarf
      else if (s.type == 1) emitPixel(sx, sy, b, b * 0.97f, b * 0.90f, 200000 + i, other);
      else                  emitPixel(sx, sy, b * 0.80f, b * 0.86f, b, 200000 + i, other);
    }
  }
  // --- the Oort cloud: a faint shell of comets far outside the planets ---
  float oortA = 0.45f * smoothstepf(13.3f, 14.3f, logW) * (1.0f - smoothstepf(16.8f, 17.8f, logW));
  if (oortA > 0.0f) {
    for (int i = 0; i < N_OORT; i++) {
      float rAU = 2000.0f * powf(50.0f, hash01(i * 3 + 41));
      float th = hash01(i * 3 + 43) * TWO_PI;
      float b = oortA * env * (0.6f + 0.4f * hash01(i * 3 + 47));
      emitPixel(scrX(sunRelX + rAU * AU * cosf(th)), scrY(sunRelY + rAU * AU * sinf(th)),
                b * 0.55f, b * 0.65f, b * 0.85f, 300000 + i, other);
    }
  }
  // --- orbits ---
  const int nPl = sizeof(PLANETS) / sizeof(PLANETS[0]);
  for (int i = 0; i < nPl; i++) {
    float ra = PLANETS[i].a * ppm;
    float alpha = 0.38f * smoothstepf(2.5f, 7.0f, ra) * (1.0f - smoothstepf(300.0f, 600.0f, ra)) * env;
    emitRing(sunSx, sunSy, ra, alpha, 1000 + i, other);
  }
  const float moonRa = MOON_A * ppm;
  emitRing(scrX(0.0f), scrY(0.0f), moonRa, 0.38f * smoothstepf(2.5f, 7.0f, moonRa) * (1.0f - smoothstepf(300.0f, 600.0f, moonRa)) * env, 1100, other);

  // --- the Sun ---
  {
    float rs = SUN_RADIUS * ppm;
    float rb = fmaxf(rs, 2.6f - 1.6f * smoothstepf(16.0f, 18.0f, logW));
    emitSun(sunSx, sunSy, rs, rb, env, other);
    float here = smoothstepf(19.6f, 20.4f, logW) * z.pulse * env;   // "you are here", once the galaxy shows
    if (here > 0.02f) emitBody(sunSx, sunSy, here, here, here * 0.9f, 700, other);
  }
  // --- planets (the Earth is one of them) ---
  for (int i = 0; i < nPl; i++) {
    const Planet &p = PLANETS[i];
    float th = TWO_PI * z.days / p.period + p.phase0;
    float relX = p.a * cosf(th) - z.earthX, relY = p.a * sinf(th) - z.earthY;   // relative to the Earth
    float sx = scrX(relX), sy = scrY(relY);
    float rpx = p.radius * ppm;
    float ra = p.a * ppm;
    // light from the Sun, as a 3D direction in view space
    float dX = sunRelX - relX, dY = sunRelY - relY;
    float dn = sqrtf(dX * dX + dY * dY); dX /= dn; dY /= dn;
    float lx = dX, ly = dY * VT, lz = -dY * CT;
    if (i == EARTH_IX) {
      if (rpx >= 20.0f) {
        float sizeF = clampf(rpx / 11.0f, 2.0f, 5.0f);
        if (cullAll && sizeF > 3.0f) sizeF = 3.0f;   // the merge is the heavy part: smaller dots
        emitEarthDots(sx, sy, rpx, sphere, spin, reachAmt, lx, ly, lz, sizeF, env, other, withBack);
      } else if (rpx >= 0.6f) {
        emitMiniGlobe(sx, sy, rpx, spin, lx, ly, lz, env, other);
      } else if (fabsf(sx - sunSx) > 1.5f || fabsf(sy - sunSy) > 1.5f) {
        emitBody(sx, sy, p.r * env, p.g * env, p.b * env, 500 + i, other);
      }
      continue;
    }
    if (rpx >= 0.6f) {
      emitDisc(sx, sy, rpx, p.r, p.g, p.b, lx, ly, lz, env, 500 + i, other);
    } else {
      float vis = smoothstepf(2.5f, 6.0f, ra) * env;
      if (vis > 0.02f && (fabsf(sx - sunSx) > 1.5f || fabsf(sy - sunSy) > 1.5f))
        emitBody(sx, sy, p.r * vis, p.g * vis, p.b * vis, 500 + i, other);
    }
  }
  // --- the Moon ---
  {
    float th = TWO_PI * z.days / MOON_PERIOD + 0.8f;
    float relX = MOON_A * cosf(th), relY = MOON_A * sinf(th);
    float sx = scrX(relX), sy = scrY(relY);
    float rpx = MOON_RADIUS * ppm;
    float dX = sunRelX - relX, dY = sunRelY - relY;
    float dn = sqrtf(dX * dX + dY * dY); dX /= dn; dY /= dn;
    if (rpx >= 0.6f) emitDisc(sx, sy, rpx, 0.72f, 0.72f, 0.70f, dX, dY * VT, -dY * CT, env, 600, other);
    else {
      float vis = smoothstepf(2.5f, 6.0f, moonRa) * env;
      if (vis > 0.02f) emitBody(sx, sy, 0.72f * vis, 0.72f * vis, 0.70f * vis, 600, other);
    }
  }
}

// ================================== rendering ==================================

static void renderScene(float t, float tShared, float dt) {
  const float P = sceneP;
  const float sgn = sideSmooth >= 0 ? 1.0f : -1.0f;          // +1: I'm the left board
  const float m = clampf((P - MERGE_START) / (MERGE_FULL - MERGE_START), 0.0f, 1.0f);   // 0 = scene, 1 = black hole
  const float reachAmt = clampf(P / MERGE_START, 0.0f, 1.0f) * (1.0f - m);

  // --- where we are in the zoom ---
  ZoomState z;
  const float cycleS = ZOOM_MINUTES * 60.0f;
  const float phase = fmodf(tShared, cycleS) / cycleS;
  float rate;
  zoomAt(phase, z.logW, rate);
  z.ppm = W / powf(10.0f, z.logW);
  z.days = simDaysAt(phase);
  z.env = smoothstepf(0.0f, FADE_IN_END, phase) * (1.0f - smoothstepf(FADE_OUT_BEG, FADE_OUT_END, phase));
  z.pulse = 0.65f + 0.35f * sinf(t * 3.0f);
  curLogW = z.logW; curPpm = z.ppm; curEnv = z.env;
  {
    const Planet &e = PLANETS[EARTH_IX];
    float th = TWO_PI * z.days / e.period + e.phase0;
    z.earthX = e.a * cosf(th); z.earthY = e.a * sinf(th);
    // the camera stays on the Earth, then hands over to the Sun as the Sun comes into view
    float s = smoothstepf(11.0f, 12.6f, z.logW);
    z.camX = -z.earthX * s; z.camY = -z.earthY * s;
  }
  spinExtra = fmodf(spinExtra + dt * 0.8f * P, TWO_PI);
  const float rotY = TWO_PI * z.days + spinExtra;              // one turn per simulated day
  const float earthRpx = PLANETS[EARTH_IX].radius * z.ppm;

  // --- background: soft warm glow (only while the hole exists) ---
  if (glowBuiltFor != sgn) buildGlow(sgn);
  if (m > 0.01f) {
    for (int v = 0; v < 256; v++) {
      float g = (v / 255.0f) * m * 0.42f;
      glowLut[v] = pack(g, g * 0.60f, g * 0.30f);
    }
#if FLIP_SCREEN
    for (int i = 0; i < W * H; i++) fb[W * H - 1 - i] = glowLut[glowMap[i]];
#else
    for (int i = 0; i < W * H; i++) fb[i] = glowLut[glowMap[i]];
#endif
  } else {
    memset(fb, 0, sizeof(fb));
  }

  const float hcx = holeCenterX(sgn);
  const float hcy = H * 0.5f;
  const float hR  = HOLE_RADIUS * smoothstepf(0.0f, 1.0f, m);
  const float Rh  = HOLE_RADIUS;

  // --- far background stars, pushed outward around the hole (gravitational lensing) ---
  for (int i = 0; i < NUM_STARS; i++) {
    float dx = stars[i].x - hcx, dy = stars[i].y - hcy;
    float d2 = dx * dx + dy * dy + 1.0f;
    float push = 1.0f + m * (hR * hR * 1.6f) / d2;
    float twinkle = 0.75f + 0.25f * sinf(t * 2.0f + i);
    float v = stars[i].b * twinkle * (0.5f + 0.3f * m) * (0.4f + 0.6f * z.env);
    float sx = hcx + dx * push, sy = hcy + dy * push;
    float rx = sx - hcx, ry = sy - hcy;
    if (m > 0.01f && rx * rx + ry * ry < hR * hR * 1.3f) continue;   // swallowed
    plot((int)sx, (int)sy, pack(v, v, v));
  }

  // --- emit the scene: my copy, and the other board's copy when it can reach my screen ---
  nParts = 0;
  cullAll = m > 0.0f;
  const float oxMine  = W * 0.5f + sgn * 9.0f * reachAmt;
  const float oxOther = W * 0.5f + sgn * (W + GAP_PX) - sgn * 9.0f * reachAmt;
  const float spinL = rotY, spinR = rotY + PI;                 // the two boards show opposite sides
  cullX0 = -3.0f; cullX1 = W + 2.0f;
  emitScene(z, oxMine, H * 0.5f, sgn, sgn > 0 ? spinL : spinR, reachAmt, false, cullAll);
  bool emitOther = cullAll;
  if (!emitOther && reachAmt > 0.0f && earthRpx >= 20.0f) {
    float extent = earthRpx * (1.0f + REACH_AMP * reachAmt) * 1.42f;
    emitOther = (oxOther - extent < W && oxOther + extent > 0);
  }
  if (emitOther) {
    cullX0 = oxOther - W * 0.5f - 3.0f; cullX1 = oxOther + W * 0.5f + 2.0f;
    emitScene(z, oxOther, H * 0.5f, -sgn, sgn > 0 ? spinR : spinL, reachAmt, true, cullAll);
  }

  // --- boards apart: just draw it ---
  if (m <= 0.0f) {
    for (int i = 0; i < nParts; i++) {
      const Part &p = parts[i];
      if (p.fl & PF_BACK) continue;
      fillRect(p.x, p.y, p.size, p.size, p.c);
    }
    return;
  }

  // --- merging: every particle spirals from where it is into its slot in the disk ---
  const float sE = sinf(0.17f);                       // we see the disk almost edge-on
  const float cD = cosf(DISK_TILT), sD = sinf(DISK_TILT);
  for (int i = 0; i < nParts; i++) {
    Part &p = parts[i];
    const bool other = p.fl & PF_OTHER;
    const float ox = other ? oxOther : oxMine;
    const float sph = other ? -sgn : sgn;
    const float spx = p.x + p.size * 0.5f, spy = p.y + p.size * 0.5f;
    const bool sFront = !(p.fl & PF_BACK);

    // per-particle merge progress: the side facing the gap is torn off first
    float dp = clampf((spx - ox) / (W * 0.5f), -1.0f, 1.0f) * sph;
    float delay = (1.0f - dp) * 0.5f;              // 0 facing gap .. 1 facing away
    float mi = smoothstepf(0.0f, 1.0f, m * 1.7f - delay * 0.7f);
    if (mi <= 0.0f) {                              // not torn off yet: drawn as is, after the hole
      if (sFront) p.fl |= PF_FRONT;
      continue;
    }

    // ---- shared disk slot (identical on both boards, driven by the shared clock) ----
    float rdn = DISK_INNER + (DISK_OUTER - DISK_INNER) * (p.u / 255.0f);
    float omega = 1.3f / (rdn * sqrtf(rdn));
    float jitter = (hash01(p.u * 256 + p.a) - 0.5f) * 0.10f;
    float th = p.a * (TWO_PI / 256.0f) - tShared * omega;
    float ct = cosf(th), st = sinf(th);
    float rpx = rdn * Rh;
    float dzp = -rpx * st;                         // > 0 = far side (behind the hole)
    bool  dFront = dzp < 0;
    bool  front  = mi < 0.5f ? sFront : dFront;
    bool  drawLens = (!dFront && mi > 0.05f && hR > 2.0f);

    float ux = rpx * ct;
    float uy = dzp * sE + jitter * Rh;
    float vx = ux * cD + uy * sD;
    float vy = -ux * sD + uy * cD;
    float dpx = hcx + vx, dpy = hcy - vy;

    float k = (rdn - DISK_INNER) / (DISK_OUTER - DISK_INNER);
    float hr, hg, hb;
    diskColor(k, hr, hg, hb);
    float doppler = 1.0f - 0.45f * ct;
    float red = ct > 0 ? ct : 0.0f;
    hg *= 1.0f - 0.35f * red;
    hb *= 1.0f - 0.60f * red;

    // ---- tidal stream: spiral around the hole from where it is to its disk slot ----
    float px, py;
    if (mi >= 1.0f) { px = dpx; py = dpy; }
    else {
      float ax = spx - hcx, ay = hcy - spy;
      float bx = dpx - hcx, by = hcy - dpy;
      float ra = sqrtf(ax * ax + ay * ay), aa = atan2f(ay, ax);
      float rb = sqrtf(bx * bx + by * by), ab = atan2f(by, bx);
      float dth = ab - aa;
      while (dth > 0.0f) dth -= TWO_PI;
      while (dth <= -TWO_PI) dth += TWO_PI;
      float rr = ra + (rb - ra) * mi;
      rr *= 1.0f - STREAM_DIP * sinf(PI * mi);
      float rmin = hR * 1.08f;
      if (rr < rmin) rr = rmin;
      float a = aa + dth * mi;
      px = hcx + rr * cosf(a);
      py = hcy - rr * sinf(a);
    }

    bool drawn = false;
    if (px >= -2 && px <= W + 1 && py >= -2 && py <= H + 1) {
      float er, eg, eb;
      unpack(p.c, er, eg, eb);
      if (!sFront) {                               // far-side dots fade in as they're pulled off
        float f = smoothstepf(0.0f, 0.3f, mi);
        er *= f; eg *= f; eb *= f;
      }
      float db = (dFront ? 1.0f : 0.80f) * (1.0f - 0.55f * k) * doppler;
      float heat = 1.0f + 0.3f * sinf(PI * mi);
      float cr = (er + (hr * db - er) * mi) * heat;
      float cg = (eg + (hg * db - eg) * mi) * heat;
      float cb = (eb + (hb * db - eb) * mi) * heat;
      bool hidden = false;
      if (!front && mi > 0.5f) {
        float ex = px - hcx, ey = py - hcy;
        hidden = ex * ex + ey * ey < hR * hR;
      }
      if (!hidden) {
        uint16_t c = pack(cr, cg, cb);
        int size = (front || mi > 0.5f) ? 2 : 1;
        if (front) { p.x = (int16_t)px; p.y = (int16_t)py; p.c = c; p.size = (uint8_t)size; p.fl |= PF_FRONT; }
        else fillRect((int)px, (int)py, size, size, c);
        drawn = true;
      }
    }
    if (!drawn) p.fl &= ~PF_FRONT;

    if (drawLens) {
      float far = dzp / rpx;
      float lb = smoothstepf(0.4f, 1.0f, mi) * 0.90f * (1.0f - 0.5f * k) * doppler;
      float lr = hR * (1.10f + 0.40f * k);
      float ax = ct * lr, ay = far * lr * 1.04f;
      float lx = hcx + ax * cD + ay * sD, ly = hcy - (-ax * sD + ay * cD);
      fillRect((int)lx, (int)ly, 2, 1, pack(hr * lb, hg * lb, hb * lb));
      float lr2 = hR * (1.06f + 0.12f * k);
      float bx = ct * lr2, by = -far * lr2;
      float l2x = hcx + bx * cD + by * sD, l2y = hcy - (-bx * sD + by * cD);
      float lb2 = lb * 0.40f;
      plot((int)l2x, (int)l2y, pack(hr * lb2, hg * lb2, hb * lb2));
    }
  }

  // the event horizon, then everything in front of it
  if (m > 0.01f) {
    fillCircle(hcx, hcy, hR * 1.05f, pack(0.95f * m, 0.90f * m, 0.80f * m));
    fillCircle(hcx, hcy, hR, 0);
  }
  for (int i = 0; i < nParts; i++) {
    const Part &p = parts[i];
    if (p.fl & PF_FRONT) fillRect(p.x, p.y, p.size, p.size, p.c);
  }
}

// Map-style scale bar, bottom left: a round length in km, AU or light-years.
static void drawScaleBar(float ppm, float alpha) {
  if (alpha <= 0.02f) return;
  float widthM = W / ppm;
  float unitM; const char *unit;
  if (widthM < 2e9f)       { unitM = 1e3f; unit = "KM"; }
  else if (widthM < 2e15f) { unitM = AU;   unit = "AU"; }
  else                     { unitM = LY;   unit = "LY"; }
  float maxLen = 70.0f / (ppm * unitM);               // longest bar that fits, in that unit
  float p = powf(10.0f, floorf(log10f(maxLen)));
  float v = maxLen >= 5 * p ? 5 * p : (maxLen >= 2 * p ? 2 * p : p);
  int len = (int)(v * unitM * ppm);
  char buf[16];
  if (v >= 1.0f)      snprintf(buf, sizeof(buf), "%d %s", (int)(v + 0.5f), unit);
  else if (v >= 0.1f) snprintf(buf, sizeof(buf), "0.%d %s", (int)(v * 10.0f + 0.5f), unit);
  else                snprintf(buf, sizeof(buf), "0.0%d %s", (int)(v * 100.0f + 0.5f), unit);
  uint16_t c = pack(0.70f * alpha, 0.72f * alpha, 0.78f * alpha);
  fillRect(3, H - 4, len + 1, 1, c);
  fillRect(3, H - 6, 1, 3, c);
  fillRect(3 + len, H - 6, 1, 3, c);
  drawText(3, H - 12, buf, c, 1);
}

static float fpsSmooth = 0.0f;

static void renderDebug(bool linked, float rssi) {
  uint16_t white = rgb565(255, 255, 255);
  uint16_t dim   = rgb565(60, 60, 60);
  char buf[12];
  if (linked) snprintf(buf, sizeof(buf), "%d", (int)roundf(rssi));
  else        snprintf(buf, sizeof(buf), "---");
  drawText(2, 2, buf, white, 2);
  snprintf(buf, sizeof(buf), "%d", (int)roundf(fpsSmooth));        // frames per second
  drawText(2, 15, buf, rgb565(0, 200, 255), 2);
  int lw10 = (int)roundf(curLogW * 10.0f);                         // zoom: screen width, log10 metres
  snprintf(buf, sizeof(buf), "%d.%d", lw10 / 10, lw10 % 10);
  drawText(2, 28, buf, rgb565(255, 140, 0), 2);
  drawText(W - 8, 2, sideSmooth > 0 ? "L" : "R", white, 2);
  fillRect(W - 14, 4, 4, 4, linked ? rgb565(0, 255, 0) : rgb565(255, 0, 0));
  fillRect(2, H - 6, W - 4, 4, dim);
  fillRect(2, H - 6, (int)((W - 4) * sceneP), 4, white);
  uint16_t tick = rgb565(255, 140, 0);
  fillRect(2 + (int)((W - 5) * MERGE_START), H - 9, 1, 3, tick);
  fillRect(2 + (int)((W - 5) * MERGE_FULL),  H - 9, 1, 3, tick);
}

static void bootTest() {
  uint16_t red = rgb565(255, 0, 0), green = rgb565(0, 255, 0), blue = rgb565(0, 0, 255);
  uint16_t white = rgb565(255, 255, 255);
  fillRect(0, 0, W, H / 3, red);
  fillRect(0, H / 3, W, H / 3, green);
  fillRect(0, 2 * H / 3, W, H - 2 * H / 3, blue);
  for (int i = 0; i < W; i++) { plot(i, 0, white); plot(i, H - 1, white); }
  for (int j = 0; j < H; j++) { plot(0, j, white); plot(W - 1, j, white); }
  tqt::pushFrame(fb);
  delay(1200);
}

// =================================== buttons ===================================

struct Button {
  int pin; bool last = true; uint32_t t = 0;
  explicit Button(int p) : pin(p) {}
  bool pressed() {                                     // true once per press
    bool now = digitalRead(pin);
    if (now != last && millis() - t > 40) {
      t = millis(); last = now;
      return now == LOW;
    }
    return false;
  }
};
static Button btnBoot(PIN_BTN_BOOT), btnKey(PIN_BTN_KEY);

// ==================================== main =====================================

void setup() {
  Serial.begin(115200);
  pinMode(PIN_BTN_BOOT, INPUT_PULLUP);
  pinMode(PIN_BTN_KEY, INPUT_PULLUP);

  tqt::begin(PANEL_VERSION, BACKLIGHT_ON);
  bootTest();

  prefs.begin("spheres", false);
  mySwap = prefs.getUChar("swap", 0);

  radioBegin();
  buildScene();
  buildDayTable();

  Serial.printf("\nMiniGalaxy_Zoom  panel=V%d  dots=%d  cycle=%.0f min  mac=%02X:%02X:%02X:%02X:%02X:%02X\n",
                PANEL_VERSION, numDots, ZOOM_MINUTES, myMac[0], myMac[1], myMac[2], myMac[3], myMac[4], myMac[5]);
}

void loop() {
  static uint32_t lastFrameUs = micros();
  static uint32_t lastTxMs = 0, lastLogMs = 0, lastClockRx = 0;

  uint32_t nowUs = micros();
  float dt = clampf((nowUs - lastFrameUs) * 1e-6f, 0.0f, 0.1f);
  lastFrameUs = nowUs;
  float t = millis() * 0.001f;
  if (dt > 0.0f) fpsSmooth += (1.0f / dt - fpsSmooth) * 0.1f;

  if (millis() - lastTxMs >= 25) { lastTxMs = millis(); radioSend(); }

  if (btnKey.pressed()) {
    mySwap++;
    prefs.putUChar("swap", mySwap);
    Serial.println("Swapped left/right");
  }
  if (btnBoot.pressed()) showDebug = !showDebug;

  // snapshot link state
  uint32_t lastRx, pClock, pClockRx;
  uint8_t pSwap, pProx, pMac[6];
  portENTER_CRITICAL(&linkMux);
  lastRx = lastRxMs; pSwap = peerSwap; pProx = peerProxByte;
  pClock = peerClockMs; pClockRx = peerClockRxMs;
  memcpy(pMac, peerMac, 6);
  portEXIT_CRITICAL(&linkMux);

  bool linked = lastRx != 0 && (millis() - lastRx) < 800;
  bool lowerMac = memcmp(myMac, pMac, 6) < 0;

  // Shared clock: whichever board's clock is further ahead wins, so the cycle never jumps back
  // (a board that reboots or is flashed later simply joins the running one). Small drift is
  // smoothed out by the higher-MAC board following the lower-MAC one.
  if (!linked) {
    clockSynced = false;
  } else if (pClockRx != lastClockRx) {
    lastClockRx = pClockRx;
    int32_t est = (int32_t)(pClock - pClockRx) + 3;    // the peer's clock, as an offset on my millis (+3 ms air time)
    if (est - clockOffset > 500)        clockOffset = est;                       // peer is ahead: jump forward to it
    else if (!lowerMac && est - clockOffset > -500) clockOffset += (est - clockOffset) / 8;
    clockSynced = true;
  }

  // proximity from signal strength
  float rawRssi = rssiMedian();
  float target = 0.0f;
  if (linked) {
    float a = 1.0f - expf(-dt * 6.0f);
    rssiFiltered = (rssiFiltered < -99.0f) ? rawRssi : rssiFiltered + (rawRssi - rssiFiltered) * a;
    target = clampf((rssiFiltered - RSSI_FAR) / (RSSI_NEAR - RSSI_FAR), 0.0f, 1.0f);
  } else {
    rssiFiltered = -100.0f;
  }
  prox += (target - prox) * (1.0f - expf(-dt * 4.0f));
  float sharedTarget = linked ? 0.5f * (prox + pProx / 255.0f) : prox;
  float nextP = sceneP + (sharedTarget - sceneP) * (1.0f - expf(-dt * 6.0f));
  if (nextP > sceneP && nextP > MERGE_START) {
    float maxUp = (MERGE_FULL - MERGE_START) / FORM_SECONDS * dt;
    nextP = fminf(nextP, fmaxf(sceneP, MERGE_START) + maxUp);
  }
  sceneP = nextP;

  // which board is on the left? Lower MAC = left; the KEY button flips both.
  bool flipped = ((mySwap + pSwap) & 1) != 0;
  float sideTarget = (lowerMac != flipped) ? 1.0f : -1.0f;
  sideSmooth += (sideTarget - sideSmooth) * (1.0f - expf(-dt * 5.0f));

  float tShared = (sharedMillis() % 3600000UL) * 0.001f;
  renderScene(t, tShared, dt);
  if (showDebug) renderDebug(linked, rssiFiltered);
  else drawScaleBar(curPpm, curEnv * (1.0f - clampf(sceneP / MERGE_START, 0.0f, 1.0f)));
  tqt::pushFrame(fb);

  if (millis() - lastLogMs > 500) {
    lastLogMs = millis();
    Serial.printf("linked=%d  rssi=%.1f  prox=%.2f  shared=%.2f  side=%s  logW=%.2f  parts=%d  fps=%.0f\n",
                  linked, rssiFiltered, prox, sceneP, sideSmooth > 0 ? "L" : "R", curLogW, nParts, fpsSmooth);
  }
}
