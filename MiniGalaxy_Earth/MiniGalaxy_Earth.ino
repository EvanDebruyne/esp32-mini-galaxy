// MiniGalaxy_Earth — two LilyGO T-QT Pro boards.
//
// Apart:           each board shows a slowly turning chunky-pixel Earth (blue oceans, green
//                  land) floating among the stars.
// Close:           the Earths stretch toward each other and their tips touch across the gap.
// Almost touching: both Earths are torn apart and spiral into ONE black hole sitting in the
//                  bezel gap between the screens. The accretion disk spans both screens.
// Other looks live in extras/: rainbow spheres, a detailed Earth with clouds and city lights.
//
// Both boards draw the SAME scene: a virtual canvas 128 + GAP_PX + 128 pixels wide holding
// the left sphere, the right sphere and the hole in the middle. Each board shows its own
// 128-px window of that canvas, so the left sphere's tip can poke into the right screen and
// the disk is continuous across the gap.
//
// How it works: both boards broadcast a small ESP-NOW packet ~40x per second (no router,
// no Wi-Fi network). Each board uses the other's signal strength (RSSI) as a rough distance
// sensor. The packets also carry a shared clock and each board's proximity value, so both
// halves of the scene animate in sync.
//
// Flash the SAME sketch to both boards. See README.md for Arduino IDE settings.
// To preview the animation on the PC without flashing: python sim/preview_earth.py
//
// Buttons:
//   KEY  (right button, IO47) : swap which board is "left" (flips BOTH boards)
//   BOOT (left button,  IO0)  : toggle the debug overlay (signal strength, frames per second
//                               in blue, L/R, proximity bar)

#include <Arduino.h>
#include <SPI.h>
#include <WiFi.h>
#include <esp_now.h>
#include <esp_wifi.h>
#include <Preferences.h>
#include "tqt_display.h"
#include "earth_map.h"     // generated by sim/make_earth_map.py

#if !defined(ESP_ARDUINO_VERSION_MAJOR) || ESP_ARDUINO_VERSION_MAJOR < 3
#error "Install 'esp32 by Espressif Systems' version 3.x in Boards Manager (2.x won't work)."
#endif

// ============================ SETTINGS YOU MAY TWEAK ============================

// LilyGO has shipped three different screens on this board: 1, 2 or 3.
#define PANEL_VERSION 3
#define BACKLIGHT_ON LOW
#define FLIP_SCREEN 1

// Signal strength (dBm) where the effect STARTS and where it's at FULL strength.
// Closer to 0 = stronger signal = boards closer. Use the debug overlay (BOOT button)
// to read live values.
//   RSSI_FAR        -> the spheres start stretching toward each other
//   MERGE_START_DBM -> the spheres start tearing apart and falling into the black hole
//   MERGE_FULL_DBM  -> the black hole is fully formed (its final look)
// Everything in between morphs gradually. Keep FAR < MERGE_START_DBM < MERGE_FULL_DBM.
// Below RSSI_FAR the spheres just sit there. Touching boards read about -11 to -7.
const float RSSI_FAR        = -20.0f;
const float MERGE_START_DBM = -17.0f;
const float MERGE_FULL_DBM  = -13.0f;
const float RSSI_NEAR       = MERGE_FULL_DBM;   // proximity hits 1.0 here

// Minimum time (seconds) for the black hole to form from start to finish, even if the
// boards are slammed together. Moving them apart undoes it at normal speed.
const float FORM_SECONDS    = 4.0f;

// The same thresholds as proximity values (0..1). Proximity is linear in dBm.
const float MERGE_START = (MERGE_START_DBM - RSSI_FAR) / (RSSI_NEAR - RSSI_FAR);
const float MERGE_FULL  = (MERGE_FULL_DBM  - RSSI_FAR) / (RSSI_NEAR - RSSI_FAR);

// Shared black hole geometry.
// GAP_PX = how many "pixels" of invisible screen sit between the two displays when the
// boards are side by side (the bezels). Tweak until the disk lines up across the gap.
const float GAP_PX      = 24.0f;
const float HOLE_RADIUS = 44.0f;     // event horizon radius in pixels
const float DISK_TILT   = 0.10f;     // slight tilt of the whole disk (radians)
const float DISK_INNER  = 1.20f;     // disk radii, in horizon radii
const float DISK_OUTER  = 3.40f;
const float REACH_AMP   = 0.60f;     // how far a sphere stretches toward the other one
const float STREAM_DIP  = 0.22f;     // how far the in-falling stream dives toward the hole

const wifi_power_t TX_POWER = WIFI_POWER_2dBm;
const uint8_t ESPNOW_CHANNEL = 1;

// Sphere look
const float SPHERE_RADIUS = 55.0f;   // pixels (screen is 128 wide)
const int   RINGS         = 36;      // latitude rows of dots (36 rings = ~1650 dots)
const int   NUM_STARS     = 90;

// Earth look
const float SPIN_PERIOD_S  = 60.0f;  // seconds per Earth turn (must divide 3600)
const float SUN_X = -0.62f, SUN_Y = 0.30f, SUN_Z = 0.72f;   // sunlight from the left, a bit above, toward you

// Simple palette: two blues for the sea, three greens for the land.
// Indexed by the surface class in EARTH_LAND (see sim/make_earth_map.py).
static const float SEA_DEEP[3]    = {0.03f, 0.10f, 0.38f};
static const float SEA_SHALLOW[3] = {0.10f, 0.34f, 0.72f};
static const float LAND_DARK[3]   = {0.08f, 0.38f, 0.10f};
static const float LAND_MID[3]    = {0.22f, 0.58f, 0.14f};
static const float LAND_LIGHT[3]  = {0.48f, 0.76f, 0.24f};
static const float *const EARTH_PAL[16] = {
  SEA_DEEP, SEA_DEEP, SEA_SHALLOW,        // deep ocean, ocean, coastal shelf
  LAND_LIGHT, LAND_MID, LAND_DARK,        // ice, tundra, boreal forest
  LAND_DARK, LAND_MID, LAND_LIGHT,        // forest, grassland, desert
  LAND_MID, LAND_DARK, LAND_MID,          // steppe, rainforest, mountains
  SEA_DEEP, SEA_DEEP, SEA_DEEP, SEA_DEEP, // sea ice, unused
};

// ================================================================================

constexpr int W = tqt::W, H = tqt::H;
static uint16_t fb[W * H];           // framebuffer, byte-swapped RGB565

const int PIN_BTN_BOOT = 0;
const int PIN_BTN_KEY  = 47;

// ---------- particles ----------
struct Dot {
  float x, y, z;           // sphere position
  float rdn, ang, omega;   // disk orbit: radius (in horizon radii), start angle, angular speed
  float jitter;            // small vertical offset so the disk has thickness
  uint8_t  land;           // Earth surface class under this dot
};
const int MAX_DOTS = 1700;

// Things in front of the black hole are drawn after it. While working out each dot once per
// frame, the ones in front are parked here and drawn at the end.
struct FrontPx { int16_t x, y; uint16_t c; uint8_t size; };
const int MAX_FRONT = MAX_DOTS * 2;              // both spheres
static FrontPx frontBuf[MAX_FRONT];
static int nFront = 0;
static inline void queueFront(int x, int y, int size, uint16_t c) {
  if (nFront < MAX_FRONT) frontBuf[nFront++] = {(int16_t)x, (int16_t)y, c, (uint8_t)size};
}
static Dot dots[MAX_DOTS];
static int numDots = 0;

struct Star { float b; };
static Star stars[NUM_STARS];

static uint8_t  glowMap[W * H];      // precomputed soft glow behind the black hole (this board's half)
static float    glowBuiltFor = 0.0f; // which side the glow map was built for (+1 / -1)
static uint16_t glowLut[256];

// ---------- radio link ----------
struct __attribute__((packed)) Packet {
  uint32_t magic;
  uint8_t  version;
  uint8_t  swapCount;
  uint16_t seq;
  uint32_t clockMs;      // sender's shared clock
  uint8_t  prox;         // sender's proximity 0..255
};
const uint32_t MAGIC = 0x50535154;   // "TQSP"
const uint8_t  PROTO = 2;
const uint8_t  BCAST[6] = {0xFF, 0xFF, 0xFF, 0xFF, 0xFF, 0xFF};

static portMUX_TYPE linkMux = portMUX_INITIALIZER_UNLOCKED;
const int RSSI_BUF = 8;
static volatile int8_t   rssiBuf[RSSI_BUF];
static volatile uint32_t rssiCount = 0;
static volatile uint32_t lastRxMs = 0;
static volatile uint8_t  peerSwap = 0;
static volatile uint8_t  peerProxByte = 0;
static volatile uint32_t peerClockMs = 0;
static volatile uint32_t peerClockRxMs = 0;
static uint8_t peerMac[6] = {0};
static uint8_t myMac[6]   = {0};

static uint8_t  mySwap = 0;
static uint16_t txSeq = 0;
static Preferences prefs;
static int32_t  clockOffset = 0;     // shared clock = millis() + clockOffset
static bool     clockSynced = false;

// ---------- animation state ----------
static float rssiFiltered = -100.0f;
static float prox = 0.0f;            // this board's own proximity estimate, 0..1
static float sceneP = 0.0f;          // proximity used for drawing (averaged with the peer's)
static float sideSmooth = 1.0f;      // +1 = I'm the LEFT board (peer on my right), -1 = right board
static float spinExtra = 0.0f;       // extra sphere spin that builds up while close
static bool  showDebug = false;

// =================================== helpers ===================================

static inline float clampf(float v, float lo, float hi) { return v < lo ? lo : (v > hi ? hi : v); }

static inline float smoothstepf(float a, float b, float x) {
  float t = clampf((x - a) / (b - a), 0.0f, 1.0f);
  return t * t * (3.0f - 2.0f * t);
}

static inline uint16_t rgb565(uint8_t r, uint8_t g, uint8_t b) {
  uint16_t c = ((r & 0xF8) << 8) | ((g & 0xFC) << 3) | (b >> 3);
  return (uint16_t)((c << 8) | (c >> 8));  // byte-swap for the SPI push
}

static inline uint16_t pack(float r, float g, float b) {
  return rgb565((uint8_t)(clampf(r, 0, 1) * 255), (uint8_t)(clampf(g, 0, 1) * 255), (uint8_t)(clampf(b, 0, 1) * 255));
}

// fraction of a turn (any real number) -> 0..65535
static inline uint16_t turn16(float f) { f -= floorf(f); return (uint16_t)(f * 65536.0f); }

// Disk palette: 0 = inner edge (white-hot) -> 1 = outer edge (deep orange)
static void diskColor(float k, float &r, float &g, float &b) {
  k = clampf(k, 0.0f, 1.0f);
  if (k < 0.30f)      { float t = k / 0.30f;            r = 1.0f;               g = 1.0f - 0.08f * t;  b = 1.0f - 0.30f * t; }
  else if (k < 0.65f) { float t = (k - 0.30f) / 0.35f;  r = 1.0f;               g = 0.92f - 0.32f * t; b = 0.70f - 0.45f * t; }
  else                { float t = (k - 0.65f) / 0.35f;  r = 1.0f - 0.25f * t;   g = 0.60f - 0.32f * t; b = 0.25f - 0.18f * t; }
}

static inline void plot(int x, int y, uint16_t c) {
  if ((unsigned)x >= (unsigned)W || (unsigned)y >= (unsigned)H) return;
#if FLIP_SCREEN
  x = W - 1 - x; y = H - 1 - y;
#endif
  fb[y * W + x] = c;
}

static inline void fillRect(int x, int y, int w, int h, uint16_t c) {
  int x0 = x < 0 ? 0 : x, y0 = y < 0 ? 0 : y;    // clip once, then write rows directly
  int x1 = x + w > W ? W : x + w, y1 = y + h > H ? H : y + h;
  if (x0 >= x1 || y0 >= y1) return;
  for (int yy = y0; yy < y1; yy++) {
#if FLIP_SCREEN
    uint16_t *p = &fb[(H - 1 - yy) * W + (W - x1)];
#else
    uint16_t *p = &fb[yy * W + x0];
#endif
    for (int n = x1 - x0; n > 0; n--) *p++ = c;
  }
}

static void fillCircle(float cx, float cy, float rad, uint16_t c) {
  int r = (int)ceilf(rad);
  float r2 = rad * rad;
  int x0 = (int)floorf(cx), y0 = (int)floorf(cy);
  for (int y = -r; y <= r; y++) {
    int yy = y0 + y;
    if (yy < 0 || yy >= H) continue;
    for (int x = -r; x <= r; x++) {
      int xx = x0 + x;
      if (xx < 0 || xx >= W) continue;
      float dx = xx + 0.5f - cx, dy = yy + 0.5f - cy;
      if (dx * dx + dy * dy <= r2) plot(xx, yy, c);
    }
  }
}

static float hash01(uint32_t n) {                      // cheap repeatable pseudo-random 0..1
  n = (n ^ 61) ^ (n >> 16); n *= 9; n ^= n >> 4; n *= 0x27d4eb2d; n ^= n >> 15;
  return (n & 0xFFFFFF) / 16777216.0f;
}

// Background stars drift to give the backdrop depth. Each star lives one cycle of the travel
// parameter s: it appears somewhere, slides toward the centre while s rises (or away from it
// while s falls), fades and reappears elsewhere. Nearer stars (bigger k) travel further per
// cycle. nWrap > 0 repeats the pattern every nWrap cycles. Returns the fade envelope.
static float starPos(int i, float s, int nWrap, float &x, float &y) {
  float u = s + hash01(i * 3 + 505);
  int   n = (int)floorf(u);
  float f = u - n;
  if (nWrap > 0) n = ((n % nWrap) + nWrap) % nWrap;
  uint32_t seed = (uint32_t)(i * 7919 + n * 104729);
  float k   = 0.35f + 0.65f * hash01(i * 3 + 404);
  float ang = hash01(seed + 1) * TWO_PI;
  float r   = (6.0f + 90.0f * sqrtf(hash01(seed + 2))) * expf(-k * f);
  x = W * 0.5f + r * cosf(ang);
  y = H * 0.5f + r * sinf(ang);
  return smoothstepf(0.0f, 0.2f, f) * (1.0f - smoothstepf(0.8f, 1.0f, f));
}


// 3x5 pixel font for the debug overlay: digits, '-', 'L', 'R'
static const uint8_t FONT3x5[][5] = {
  {7,5,5,5,7}, {2,6,2,2,7}, {7,1,7,4,7}, {7,1,7,1,7}, {5,5,7,1,1},
  {7,4,7,1,7}, {7,4,7,5,7}, {7,1,1,1,1}, {7,5,7,5,7}, {7,5,7,1,7},
  {0,0,7,0,0}, {4,4,4,4,7}, {6,5,6,5,5},
};
static void drawChar(int x, int y, char ch, uint16_t c, int s) {
  int idx;
  if (ch >= '0' && ch <= '9') idx = ch - '0';
  else if (ch == '-') idx = 10;
  else if (ch == 'L') idx = 11;
  else if (ch == 'R') idx = 12;
  else return;
  for (int row = 0; row < 5; row++)
    for (int col = 0; col < 3; col++)
      if (FONT3x5[idx][row] & (4 >> col)) fillRect(x + col * s, y + row * s, s, s, c);
}
static void drawText(int x, int y, const char *str, uint16_t c, int s) {
  for (; *str; str++, x += 4 * s) drawChar(x, y, *str, c, s);
}

// ================================= radio link ==================================

static void onRecv(const esp_now_recv_info_t *info, const uint8_t *data, int len) {
  if (len != (int)sizeof(Packet)) return;
  Packet p;
  memcpy(&p, data, sizeof(p));
  if (p.magic != MAGIC || p.version != PROTO) return;
  uint32_t now = millis();
  portENTER_CRITICAL(&linkMux);
  memcpy(peerMac, info->src_addr, 6);
  rssiBuf[rssiCount % RSSI_BUF] = (int8_t)info->rx_ctrl->rssi;
  rssiCount = rssiCount + 1;
  lastRxMs = now;
  peerSwap = p.swapCount;
  peerProxByte = p.prox;
  peerClockMs = p.clockMs;
  peerClockRxMs = now;
  portEXIT_CRITICAL(&linkMux);
}

static void radioBegin() {
  WiFi.mode(WIFI_STA);
  WiFi.disconnect();
  WiFi.setTxPower(TX_POWER);
  esp_wifi_set_promiscuous(true);
  esp_wifi_set_channel(ESPNOW_CHANNEL, WIFI_SECOND_CHAN_NONE);
  esp_wifi_set_promiscuous(false);
  esp_wifi_get_mac(WIFI_IF_STA, myMac);

  if (esp_now_init() != ESP_OK) {
    Serial.println("ESP-NOW init failed");
    return;
  }
  esp_now_register_recv_cb(onRecv);

  esp_now_peer_info_t peer = {};
  memcpy(peer.peer_addr, BCAST, 6);
  peer.channel = 0;                  // 0 = current channel
  peer.ifidx = WIFI_IF_STA;
  peer.encrypt = false;
  esp_now_add_peer(&peer);
}

static inline uint32_t sharedMillis() { return millis() + (uint32_t)clockOffset; }

static void radioSend() {
  Packet p;
  p.magic = MAGIC;
  p.version = PROTO;
  p.swapCount = mySwap;
  p.seq = txSeq++;
  p.clockMs = sharedMillis();
  p.prox = (uint8_t)(clampf(prox, 0, 1) * 255.0f);
  esp_now_send(BCAST, (const uint8_t *)&p, sizeof(p));
}

// Median of the most recent RSSI samples (kills single-packet spikes)
static float rssiMedian() {
  int8_t s[RSSI_BUF];
  int n;
  portENTER_CRITICAL(&linkMux);
  n = rssiCount < RSSI_BUF ? (int)rssiCount : RSSI_BUF;
  for (int i = 0; i < n; i++) s[i] = rssiBuf[i];
  portEXIT_CRITICAL(&linkMux);
  if (n == 0) return -100;
  for (int i = 1; i < n; i++) {      // insertion sort, n <= 8
    int8_t v = s[i]; int j = i - 1;
    while (j >= 0 && s[j] > v) { s[j + 1] = s[j]; j--; }
    s[j + 1] = v;
  }
  return s[n / 2];
}

// ================================== scene =====================================

static void buildScene() {
  numDots = 0;
  for (int r = 0; r < RINGS && numDots < MAX_DOTS; r++) {
    float lat = PI * ((r + 0.5f) / RINGS) - HALF_PI;     // -90..90 deg
    float cl = cosf(lat), sl = sinf(lat);
    int count = max(1, (int)roundf(2.0f * RINGS * cl));
    for (int k = 0; k < count && numDots < MAX_DOTS; k++) {
      float lon = TWO_PI * (k + 0.5f * (r & 1)) / count;
      Dot &d = dots[numDots];
      d.x = cl * cosf(lon);
      d.y = sl;
      d.z = cl * sinf(lon);
      // what's under this dot on the Earth map
      uint16_t tu = turn16(0.5f - lon / TWO_PI);
      uint8_t  tv = (uint8_t)clampf((0.5f - lat / PI) * EARTH_TH, 0, EARTH_TH - 1);
      d.land = EARTH_LAND[tv][tu >> 8] & 15;
      // Disk slot comes from where the dot sits on the sphere (not a random hash), so
      // neighbouring dots stay neighbours while they fall in: the equator feeds the hot
      // inner edge, the poles spread out to the cool outer rim. Both boards compute the
      // exact same slots, so the disk matches across the gap.
      float u = powf(1.0f - cl, 0.55f) + 0.05f * (hash01(numDots * 2 + 1) - 0.5f);
      d.rdn = DISK_INNER + (DISK_OUTER - DISK_INNER) * clampf(u, 0.0f, 1.0f);
      d.ang = lon;
      d.omega = 1.3f / (d.rdn * sqrtf(d.rdn));           // inner orbits faster (Kepler-ish)
      d.jitter = (sl >= 0 ? 0.025f : -0.025f) + (hash01(numDots * 2 + 7) - 0.5f) * 0.05f;
      numDots++;
    }
  }
  for (int i = 0; i < NUM_STARS; i++) {
    stars[i].b = 0.15f + 0.45f * hash01(i * 3 + 303);
  }
}

// Hole centre in THIS board's screen coordinates. The left board's screen spans virtual
// x = 0..127, then GAP_PX of bezel, then the right board's screen. The hole sits in the gap.
static inline float holeCenterX(float sideSign) { return W * 0.5f + sideSign * (W * 0.5f + GAP_PX * 0.5f); }

static void buildGlow(float sideSign) {
  float hcx = holeCenterX(sideSign), hcy = H * 0.5f;
  float ct = cosf(DISK_TILT), st = sinf(DISK_TILT);
  for (int y = 0; y < H; y++) {
    for (int x = 0; x < W; x++) {
      float dx = x + 0.5f - hcx, dy = hcy - (y + 0.5f);  // dy up
      float ux =  dx * ct + dy * st;                     // un-tilt so the band follows the disk
      float uy = -dx * st + dy * ct;
      float r = sqrtf(dx * dx + dy * dy);
      float g = 0.0f;
      if (r > HOLE_RADIUS) {
        float band = expf(-fabsf(uy) / (5.0f + 0.07f * fabsf(ux))) * expf(-fabsf(ux) / 150.0f);
        float ring = expf(-fabsf(r - HOLE_RADIUS * 1.22f) / 10.0f);
        float haze = expf(-(r - HOLE_RADIUS) / 60.0f);
        // the far side of the disk, lensed over the top of the hole (and a thinner image under it)
        const float R = HOLE_RADIUS;
        float el = uy / r;                                  // 1 at the top, -1 at the bottom
        float haloUp = smoothstepf(0.15f, 0.75f, el)  * smoothstepf(1.00f * R, 1.08f * R, r) * expf(-fmaxf(r - 1.08f * R, 0.0f) / (0.22f * R));
        float haloDn = smoothstepf(0.15f, 0.75f, -el) * smoothstepf(1.00f * R, 1.06f * R, r) * expf(-fmaxf(r - 1.06f * R, 0.0f) / (0.09f * R));
        float doppler = 1.0f - 0.30f * ux / r;              // the side coming toward you is brighter
        g = 0.55f * band + 0.25f * ring + 0.25f * haze + (0.80f * haloUp + 0.35f * haloDn) * doppler;
      }
      glowMap[y * W + x] = (uint8_t)(clampf(g, 0, 1) * 255.0f);
    }
  }
  glowBuiltFor = sideSign;
}

// Stages (P = shared proximity):
//   P = 0               -> chunky-pixel Earth, slowly turning (one turn per SPIN_PERIOD_S)
//   P up to MERGE_START -> both Earths stretch toward the gap until their tips touch
//   MERGE_START..FULL   -> the side facing the gap is torn off first; every dot spirals
//                          around the hole (always in the disk's spin direction) and settles
//                          into its slot in ONE accretion disk spanning both screens.
//                          The event horizon grows in the gap between the boards.
static void renderScene(float t, float tShared, float dt) {
  const float P = sceneP;
  const float sgn = sideSmooth >= 0 ? 1.0f : -1.0f;          // +1: I'm the left board
  // linear here: each dot eases on its own below, so the morph is spread evenly over the dBm range
  const float m = clampf((P - MERGE_START) / (MERGE_FULL - MERGE_START), 0.0f, 1.0f);   // 0 = spheres, 1 = black hole
  const float reachAmt = clampf(P / MERGE_START, 0.0f, 1.0f) * (1.0f - m);

  // --- background: soft warm glow (only while the hole exists) ---
  if (glowBuiltFor != sgn) buildGlow(sgn);
  if (m > 0.01f) {
    for (int v = 0; v < 256; v++) {
      float g = (v / 255.0f) * m * 0.42f;
      glowLut[v] = pack(g, g * 0.60f, g * 0.30f);
    }
#if FLIP_SCREEN
    for (int i = 0; i < W * H; i++) fb[W * H - 1 - i] = glowLut[glowMap[i]];
#else
    for (int i = 0; i < W * H; i++) fb[i] = glowLut[glowMap[i]];
#endif
  } else {
    memset(fb, 0, sizeof(fb));
  }

  const float hcx = holeCenterX(sgn);
  const float hcy = H * 0.5f;
  const float hR  = HOLE_RADIUS * smoothstepf(0.0f, 1.0f, m);   // horizon grows in, full size at MERGE_FULL_DBM
  const float Rh  = HOLE_RADIUS;                                 // disk scale (fixed)
  const float R   = SPHERE_RADIUS;

  // Spin comes from the shared clock so both boards draw the same Earths; the extra spin
  // while close is integrated locally (both boards see ~the same P, so they agree).
  spinExtra = fmodf(spinExtra + dt * 0.8f * P, TWO_PI);
  const float rotY = TWO_PI * fmodf(tShared, SPIN_PERIOD_S) / SPIN_PERIOD_S + spinExtra;
  const float tilt = 0.42f;                           // ~ Earth's axial tilt, north pole toward you
  const float cT = cosf(tilt), sT = sinf(tilt);
  const float sE = sinf(0.17f);                       // we see the disk almost edge-on
  const float cD = cosf(DISK_TILT), sD = sinf(DISK_TILT);
  const float bright = 1.0f + 0.15f * P;
  const float sn = sqrtf(SUN_X * SUN_X + SUN_Y * SUN_Y + SUN_Z * SUN_Z);
  const float lx = SUN_X / sn, ly = SUN_Y / sn, lz = SUN_Z / sn;
  // chunky pixels while it's a globe; smaller once the merge starts (the merge is the heavy part)
  const int dotSize = m > 0.0f ? 3 : (reachAmt < 0.5f ? 5 : 4);

  // --- stars: a slow drift outward (flying forward), pushed outward around the hole ---
  for (int i = 0; i < NUM_STARS; i++) {
    float sx0, sy0;
    float senv = starPos(i, -tShared / 60.0f, 60, sx0, sy0);   // the clock wraps hourly: 60 cycles
    float dx = sx0 - hcx, dy = sy0 - hcy;
    float d2 = dx * dx + dy * dy + 1.0f;
    float push = 1.0f + m * (hR * hR * 1.6f) / d2;
    float twinkle = 0.75f + 0.25f * sinf(t * 2.0f + i);
    float v = stars[i].b * senv * twinkle * (0.5f + 0.3f * m);
    float sx = hcx + dx * push, sy = hcy + dy * push;
    float rx = sx - hcx, ry = sy - hcy;
    if (m > 0.01f && rx * rx + ry * ry < hR * hR * 1.3f) continue;   // swallowed
    plot((int)sx, (int)sy, pack(v, v, v));
  }

  // One pass over all dots: things behind the hole are drawn right away, things in front are
  // queued and drawn after the hole.
  nFront = 0;
  {
    for (int sphere = 1; sphere >= -1; sphere -= 2) {           // +1 = left sphere, -1 = right sphere
      const bool  mine   = (sphere == (int)sgn);
      const float cx     = W * 0.5f + (mine ? 0.0f : sgn * (W + GAP_PX)) + sphere * 9.0f * reachAmt;
      const float cy     = H * 0.5f;
      const float angOff = sphere > 0 ? 0.0f : PI;              // the two spheres feed interleaved disk slots
      if (!mine && m <= 0.0f) {                                 // other sphere can't reach my screen yet
        float extent = R * (1.0f + REACH_AMP * reachAmt) * 1.42f;
        if (cx - extent > W || cx + extent < 0) continue;
      }
      const float spin = rotY + (sphere > 0 ? 0.0f : PI);
      const float cR = cosf(spin), sR = sinf(spin);

      for (int i = 0; i < numDots; i++) {
        const Dot &d = dots[i];

        // ---- sphere: rotate around Y, tilt around X, stretch toward the other sphere ----
        float x1 = d.x * cR + d.z * sR;
        float z1 = -d.x * sR + d.z * cR;
        float sy = d.y * cT - z1 * sT;
        float sz = d.y * sT + z1 * cT;
        float sx = x1;
        const float nx = sx, ny = sy, nz = sz;         // surface normal before stretching, for lighting
        float dp = sx * sphere;                        // +1 = facing the other sphere
        float reach = dp > 0 ? dp * dp * dp : 0.0f;
        float back  = dp < 0 ? -dp : 0.0f;
        float r = 1.0f + reachAmt * (REACH_AMP * reach - 0.10f * back);
        float pinch = 1.0f - 0.30f * reachAmt * reach;
        sx *= r; sy *= r * pinch; sz *= r * pinch;
        float persp = 3.4f / (3.4f - sz);
        float spx = cx + sx * R * persp;
        float spy = cy - sy * R * persp;
        bool  sFront = sz >= 0;

        // per-dot merge progress: the side facing the gap is torn off first
        float delay = (1.0f - clampf(dp, -1, 1)) * 0.5f;     // 0 facing gap .. 1 facing away
        float mi = smoothstepf(0.0f, 1.0f, m * 1.7f - delay * 0.7f);

        // Earth colour of this dot: flat palette colour, simple sunlight
        float er = 0, eg = 0, eb = 0;
        auto earthColour = [&]() {
          float lit = (0.30f + 0.70f * clampf(nx * lx + ny * ly + nz * lz, 0.0f, 1.0f)) * bright;
          const float *c = EARTH_PAL[d.land];
          er = c[0] * lit; eg = c[1] * lit; eb = c[2] * lit;
        };

        if (mi <= 0.0f) {                              // still part of the globe: cheap path
          if (!sFront) continue;                       // the globe is opaque: no far side
          if (spx < -3 || spx > W + 1 || spy < -3 || spy > H + 1) continue;
          earthColour();
          queueFront((int)spx - 1, (int)spy - 1, dotSize, pack(er, eg, eb));
          continue;
        }

        // ---- shared disk slot (identical on both boards, driven by the shared clock) ----
        float th = d.ang + angOff - tShared * d.omega;
        float ct = cosf(th), st = sinf(th);
        float rpx = d.rdn * Rh;
        float dzp = -rpx * st;                         // > 0 = far side (behind the hole)
        bool  dFront = dzp < 0;
        bool  front  = mi < 0.5f ? sFront : dFront;
        bool  drawLens = (!dFront && mi > 0.05f && hR > 2.0f);

        float ux = rpx * ct;
        float uy = dzp * sE + d.jitter * Rh;           // height on screen (up)
        float vx = ux * cD + uy * sD;                  // tilt the whole disk slightly
        float vy = -ux * sD + uy * cD;
        float dpx = hcx + vx, dpy = hcy - vy;

        float k = (d.rdn - DISK_INNER) / (DISK_OUTER - DISK_INNER);   // 0 inner edge .. 1 outer edge
        float hr, hg, hb;
        diskColor(k, hr, hg, hb);
        float doppler = 1.0f - 0.45f * ct;             // side moving toward you is brighter...
        float red = ct > 0 ? ct : 0.0f;                // ...the receding side goes dim AND red
        hg *= 1.0f - 0.35f * red;
        hb *= 1.0f - 0.60f * red;

        {
          // ---- tidal stream: spiral around the hole from the sphere slot to the disk slot ----
          float px, py;
          if (mi >= 1.0f) { px = dpx; py = dpy; }
          else {
            float ax = spx - hcx, ay = hcy - spy;      // y up
            float bx = dpx - hcx, by = hcy - dpy;
            float ra = sqrtf(ax * ax + ay * ay), aa = atan2f(ay, ax);
            float rb = sqrtf(bx * bx + by * by), ab = atan2f(by, bx);
            float dth = ab - aa;
            while (dth > 0.0f) dth -= TWO_PI;          // always sweep in the disk's spin direction
            while (dth <= -TWO_PI) dth += TWO_PI;
            float rr = ra + (rb - ra) * mi;
            rr *= 1.0f - STREAM_DIP * sinf(PI * mi);
            float rmin = hR * 1.08f;
            if (rr < rmin) rr = rmin;
            float a = aa + dth * mi;
            px = hcx + rr * cosf(a);
            py = hcy - rr * sinf(a);
          }

          if (px >= -2 && px <= W + 1 && py >= -2 && py <= H + 1) {
            earthColour();
            if (!sFront) {                             // far-side dots fade in as they're pulled off
              float f = smoothstepf(0.0f, 0.3f, mi);
              er *= f; eg *= f; eb *= f;
            }
            float db = (dFront ? 1.0f : 0.80f) * (1.0f - 0.55f * k) * doppler;
            float heat = 1.0f + 0.3f * sinf(PI * mi);  // the stream runs hot
            float cr = (er + (hr * db - er) * mi) * heat;
            float cg = (eg + (hg * db - eg) * mi) * heat;
            float cb = (eb + (hb * db - eb) * mi) * heat;

            bool hidden = false;                       // far side behind the horizon
            if (!front && mi > 0.5f) {
              float ex = px - hcx, ey = py - hcy;
              hidden = ex * ex + ey * ey < hR * hR;
            }
            if (!hidden) {
              uint16_t c = pack(cr, cg, cb);
              if (front)          queueFront((int)px, (int)py, 2, c);
              else if (mi > 0.5f) fillRect((int)px, (int)py, 2, 2, c);
              else                plot((int)px, (int)py, c);
            }
          }
        }

        if (drawLens) {
          // lensed image of the FAR side of the disk, bent up over the top of the hole
          float far = dzp / rpx;                       // 0..1, 1 = directly behind
          float lb = smoothstepf(0.4f, 1.0f, mi) * 0.90f * (1.0f - 0.5f * k) * doppler;
          float lr = hR * (1.10f + 0.40f * k);
          float ax = ct * lr, ay = far * lr * 1.04f;
          float lx = hcx + ax * cD + ay * sD, ly = hcy - (-ax * sD + ay * cD);
          fillRect((int)lx, (int)ly, 2, 1, pack(hr * lb, hg * lb, hb * lb));
          // fainter secondary image hugging the bottom of the hole
          float lr2 = hR * (1.06f + 0.12f * k);
          float bx = ct * lr2, by = -far * lr2;
          float l2x = hcx + bx * cD + by * sD, l2y = hcy - (-bx * sD + by * cD);
          float lb2 = lb * 0.40f;
          plot((int)l2x, (int)l2y, pack(hr * lb2, hg * lb2, hb * lb2));
        }
      }
    }
  }

  // the event horizon, then everything in front of it
  if (m > 0.01f) {
    fillCircle(hcx, hcy, hR * 1.05f, pack(0.95f * m, 0.90f * m, 0.80f * m)); // thin bright rim
    fillCircle(hcx, hcy, hR, 0);                                         // the hole: pure black
  }
  for (int i = 0; i < nFront; i++) {
    const FrontPx &f = frontBuf[i];
    fillRect(f.x, f.y, f.size, f.size, f.c);
  }
}

static float fpsSmooth = 0.0f;

static void renderDebug(bool linked, float rssi) {
  uint16_t white = rgb565(255, 255, 255);
  uint16_t dim   = rgb565(60, 60, 60);
  char buf[8];
  if (linked) snprintf(buf, sizeof(buf), "%d", (int)roundf(rssi));
  else        snprintf(buf, sizeof(buf), "---");
  drawText(2, 2, buf, white, 2);
  snprintf(buf, sizeof(buf), "%d", (int)roundf(fpsSmooth));        // frames per second
  drawText(2, 15, buf, rgb565(0, 200, 255), 2);
  drawText(W - 8, 2, sideSmooth > 0 ? "L" : "R", white, 2);   // which board am I
  fillRect(W - 14, 4, 4, 4, linked ? rgb565(0, 255, 0) : rgb565(255, 0, 0));
  fillRect(2, H - 6, W - 4, 4, dim);
  fillRect(2, H - 6, (int)((W - 4) * sceneP), 4, white);
  // orange ticks above the bar: where the merge starts and where the hole is complete
  uint16_t tick = rgb565(255, 140, 0);
  fillRect(2 + (int)((W - 5) * MERGE_START), H - 9, 1, 3, tick);
  fillRect(2 + (int)((W - 5) * MERGE_FULL),  H - 9, 1, 3, tick);
}

static void bootTest() {
  uint16_t red = rgb565(255, 0, 0), green = rgb565(0, 255, 0), blue = rgb565(0, 0, 255);
  uint16_t white = rgb565(255, 255, 255);
  fillRect(0, 0, W, H / 3, red);
  fillRect(0, H / 3, W, H / 3, green);
  fillRect(0, 2 * H / 3, W, H - 2 * H / 3, blue);
  for (int i = 0; i < W; i++) { plot(i, 0, white); plot(i, H - 1, white); }
  for (int j = 0; j < H; j++) { plot(0, j, white); plot(W - 1, j, white); }
  tqt::pushFrame(fb);
  delay(1200);
}

// =================================== buttons ===================================

struct Button {
  int pin; bool last = true; uint32_t t = 0;
  explicit Button(int p) : pin(p) {}
  bool pressed() {                                     // true once per press
    bool now = digitalRead(pin);
    if (now != last && millis() - t > 40) {
      t = millis(); last = now;
      return now == LOW;
    }
    return false;
  }
};
static Button btnBoot(PIN_BTN_BOOT), btnKey(PIN_BTN_KEY);

// ==================================== main =====================================

void setup() {
  Serial.begin(115200);
  pinMode(PIN_BTN_BOOT, INPUT_PULLUP);
  pinMode(PIN_BTN_KEY, INPUT_PULLUP);

  tqt::begin(PANEL_VERSION, BACKLIGHT_ON);
  bootTest();

  prefs.begin("spheres", false);
  mySwap = prefs.getUChar("swap", 0);

  radioBegin();
  buildScene();

  Serial.printf("\nMiniGalaxy_Earth  panel=V%d  dots=%d  mac=%02X:%02X:%02X:%02X:%02X:%02X\n",
                PANEL_VERSION, numDots, myMac[0], myMac[1], myMac[2], myMac[3], myMac[4], myMac[5]);
}

void loop() {
  static uint32_t lastFrameUs = micros();
  static uint32_t lastTxMs = 0, lastLogMs = 0, lastClockRx = 0;

  uint32_t nowUs = micros();
  float dt = clampf((nowUs - lastFrameUs) * 1e-6f, 0.0f, 0.1f);
  lastFrameUs = nowUs;
  float t = millis() * 0.001f;
  if (dt > 0.0f) fpsSmooth += (1.0f / dt - fpsSmooth) * 0.1f;

  if (millis() - lastTxMs >= 25) { lastTxMs = millis(); radioSend(); }

  if (btnKey.pressed()) {
    mySwap++;
    prefs.putUChar("swap", mySwap);
    Serial.println("Swapped left/right");
  }
  if (btnBoot.pressed()) showDebug = !showDebug;

  // snapshot link state
  uint32_t lastRx, pClock, pClockRx;
  uint8_t pSwap, pProx, pMac[6];
  portENTER_CRITICAL(&linkMux);
  lastRx = lastRxMs; pSwap = peerSwap; pProx = peerProxByte;
  pClock = peerClockMs; pClockRx = peerClockRxMs;
  memcpy(pMac, peerMac, 6);
  portEXIT_CRITICAL(&linkMux);

  bool linked = lastRx != 0 && (millis() - lastRx) < 800;
  bool lowerMac = memcmp(myMac, pMac, 6) < 0;     // lower MAC = clock master

  // shared clock: the lower-MAC board is the master, the other one follows it
  if (!linked) {
    clockSynced = false;
  } else if (lowerMac) {
    clockOffset = 0;
  } else if (pClockRx != lastClockRx) {
    lastClockRx = pClockRx;
    int32_t est = (int32_t)(pClock - pClockRx) + 3;    // +3 ms for air time
    if (!clockSynced || abs(est - clockOffset) > 500) { clockOffset = est; clockSynced = true; }
    else clockOffset += (est - clockOffset) / 8;
  }

  // proximity from signal strength
  float rawRssi = rssiMedian();
  float target = 0.0f;
  if (linked) {
    float a = 1.0f - expf(-dt * 6.0f);
    rssiFiltered = (rssiFiltered < -99.0f) ? rawRssi : rssiFiltered + (rawRssi - rssiFiltered) * a;
    // linear in dBm, so the MERGE_*_DBM thresholds land exactly where the overlay says
    target = clampf((rssiFiltered - RSSI_FAR) / (RSSI_NEAR - RSSI_FAR), 0.0f, 1.0f);
  } else {
    rssiFiltered = -100.0f;
  }
  prox += (target - prox) * (1.0f - expf(-dt * 4.0f));
  // both boards draw with the average of the two estimates so the halves match
  float sharedTarget = linked ? 0.5f * (prox + pProx / 255.0f) : prox;
  float nextP = sceneP + (sharedTarget - sceneP) * (1.0f - expf(-dt * 6.0f));
  // inside the merge band the hole may only grow at a fixed pace, so it builds up slowly
  if (nextP > sceneP && nextP > MERGE_START) {
    float maxUp = (MERGE_FULL - MERGE_START) / FORM_SECONDS * dt;
    nextP = fminf(nextP, fmaxf(sceneP, MERGE_START) + maxUp);
  }
  sceneP = nextP;

  // which board is on the left? Lower MAC = left; the KEY button flips both.
  bool flipped = ((mySwap + pSwap) & 1) != 0;
  float sideTarget = (lowerMac != flipped) ? 1.0f : -1.0f;
  sideSmooth += (sideTarget - sideSmooth) * (1.0f - expf(-dt * 5.0f));

  float tShared = (sharedMillis() % 3600000UL) * 0.001f;
  renderScene(t, tShared, dt);
  if (showDebug) renderDebug(linked, rssiFiltered);
  tqt::pushFrame(fb);

  if (millis() - lastLogMs > 500) {
    lastLogMs = millis();
    Serial.printf("linked=%d  rssi=%.1f  prox=%.2f  shared=%.2f  side=%s  clockOfs=%ld  fps=%.0f\n",
                  linked, rssiFiltered, prox, sceneP, sideSmooth > 0 ? "L" : "R",
                  (long)clockOffset, fpsSmooth);
  }
}
