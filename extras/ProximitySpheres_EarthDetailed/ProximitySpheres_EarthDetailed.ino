// ProximitySpheres_SharedHole — two LilyGO T-QT Pro boards.
//
// Apart:           each board shows a slowly turning pixel Earth (sunlit, clouds, city
//                  lights on the night side) floating among the stars.
// Close:           the Earths break up into dots, stretch toward each other and their tips
//                  touch across the gap.
// Almost touching: both Earths are torn apart and spiral into ONE black hole sitting in the
//                  bezel gap between the screens. The accretion disk spans both screens.
// (The earlier rainbow-sphere version lives in ProximitySpheres_SharedHole_Rainbow.)
//
// Both boards draw the SAME scene: a virtual canvas 128 + GAP_PX + 128 pixels wide holding
// the left sphere, the right sphere and the hole in the middle. Each board shows its own
// 128-px window of that canvas, so the left sphere's tip can poke into the right screen and
// the disk is continuous across the gap.
//
// How it works: both boards broadcast a small ESP-NOW packet ~40x per second (no router,
// no Wi-Fi network). Each board uses the other's signal strength (RSSI) as a rough distance
// sensor. The packets also carry a shared clock and each board's proximity value, so both
// halves of the scene animate in sync.
//
// Flash the SAME sketch to both boards. See README.md for Arduino IDE settings.
// To preview the animation on the PC without flashing: python extras/sim/preview_earth_detailed.py
//
// Buttons:
//   KEY  (right button, IO47) : swap which board is "left" (flips BOTH boards)
//   BOOT (left button,  IO0)  : toggle the debug overlay (signal strength, L/R, proximity bar)

#include <Arduino.h>
#include <SPI.h>
#include <WiFi.h>
#include <esp_now.h>
#include <esp_wifi.h>
#include <Preferences.h>
#include "tqt_display.h"
#include "earth_map.h"     // generated by sim/make_earth_map.py

#if !defined(ESP_ARDUINO_VERSION_MAJOR) || ESP_ARDUINO_VERSION_MAJOR < 3
#error "Install 'esp32 by Espressif Systems' version 3.x in Boards Manager (2.x won't work)."
#endif

// ============================ SETTINGS YOU MAY TWEAK ============================

// LilyGO has shipped three different screens on this board: 1, 2 or 3.
#define PANEL_VERSION 3
#define BACKLIGHT_ON LOW
#define FLIP_SCREEN 0

// Signal strength (dBm) where the effect STARTS and where it's at FULL strength.
// Closer to 0 = stronger signal = boards closer. Use the debug overlay (BOOT button)
// to read live values.
//   RSSI_FAR        -> the spheres start stretching toward each other
//   MERGE_START_DBM -> the spheres start tearing apart and falling into the black hole
//   MERGE_FULL_DBM  -> the black hole is fully formed (its final look)
// Everything in between morphs gradually. Keep FAR < MERGE_START_DBM < MERGE_FULL_DBM.
// Below RSSI_FAR the spheres just sit there. Touching boards read about -11 to -7.
const float RSSI_FAR        = -20.0f;
const float MERGE_START_DBM = -17.0f;
const float MERGE_FULL_DBM  = -13.0f;
const float RSSI_NEAR       = MERGE_FULL_DBM;   // proximity hits 1.0 here

// Minimum time (seconds) for the black hole to form from start to finish, even if the
// boards are slammed together. Moving them apart undoes it at normal speed.
const float FORM_SECONDS    = 4.0f;

// The same thresholds as proximity values (0..1). Proximity is linear in dBm.
const float MERGE_START = (MERGE_START_DBM - RSSI_FAR) / (RSSI_NEAR - RSSI_FAR);
const float MERGE_FULL  = (MERGE_FULL_DBM  - RSSI_FAR) / (RSSI_NEAR - RSSI_FAR);

// Shared black hole geometry.
// GAP_PX = how many "pixels" of invisible screen sit between the two displays when the
// boards are side by side (the bezels). Tweak until the disk lines up across the gap.
const float GAP_PX      = 24.0f;
const float HOLE_RADIUS = 44.0f;     // event horizon radius in pixels
const float DISK_TILT   = 0.10f;     // slight tilt of the whole disk (radians)
const float DISK_INNER  = 1.20f;     // disk radii, in horizon radii
const float DISK_OUTER  = 3.40f;
const float REACH_AMP   = 0.60f;     // how far a sphere stretches toward the other one
const float STREAM_DIP  = 0.22f;     // how far the in-falling stream dives toward the hole

const wifi_power_t TX_POWER = WIFI_POWER_2dBm;
const uint8_t ESPNOW_CHANNEL = 1;

// Sphere look
const float SPHERE_RADIUS = 55.0f;   // pixels (screen is 128 wide)
const int   RINGS         = 44;      // latitude rows of dots (44 rings = ~2460 dots)
const int   NUM_STARS     = 70;

// Earth look
const float SPIN_PERIOD_S  = 60.0f;  // seconds per Earth turn (must divide 3600)
const float CLOUD_PERIOD_S = 600.0f; // clouds drift slowly over the ground (must divide 3600)
const float SUN_X = -0.62f, SUN_Y = 0.30f, SUN_Z = 0.72f;   // sunlight from the left, a bit above, toward you
const float CAM_DIST = 3.4f;         // perspective, in sphere radii (matches the dot projection)

// Surface colours, indexed by the low 4 bits of EARTH_LAND (same order as sim/make_earth_map.py)
static const float EARTH_PAL[16][3] = {
  {0.02f, 0.07f, 0.26f}, {0.03f, 0.13f, 0.40f}, {0.07f, 0.26f, 0.55f},   // deep ocean, ocean, shelf
  {0.92f, 0.95f, 1.00f}, {0.42f, 0.44f, 0.34f}, {0.10f, 0.28f, 0.12f},   // ice, tundra, boreal
  {0.17f, 0.42f, 0.13f}, {0.48f, 0.54f, 0.20f}, {0.86f, 0.68f, 0.40f},   // green, savanna, desert
  {0.63f, 0.52f, 0.30f}, {0.06f, 0.33f, 0.09f}, {0.46f, 0.37f, 0.29f},   // steppe, rainforest, mountains
  {0.78f, 0.85f, 0.93f}, {0, 0, 0}, {0, 0, 0}, {0, 0, 0},                // sea ice
};

// ================================================================================

constexpr int W = tqt::W, H = tqt::H;
static uint16_t fb[W * H];           // framebuffer, byte-swapped RGB565

const int PIN_BTN_BOOT = 0;
const int PIN_BTN_KEY  = 47;

// ---------- particles ----------
struct Dot {
  float x, y, z;           // sphere position
  float rdn, ang, omega;   // disk orbit: radius (in horizon radii), start angle, angular speed
  float jitter;            // small vertical offset so the disk has thickness
  uint16_t tu;             // Earth texture column (1/256 texel units)
  uint8_t  tv, land;       // Earth texture row + the land byte there
};
const int MAX_DOTS = 2500;
static Dot dots[MAX_DOTS];
static int numDots = 0;

// Solid Earth: for every screen pixel the planet covers (at rest), where it lands on the
// globe and how it's lit. Built once at boot; per frame only the texture lookup changes.
// Row y covers pixels x = -earthN[y] .. earthN[y]-1. The globe's geometry is mirror-symmetric,
// so only the right half (x >= 0) is stored; the left half mirrors it. Lighting is per pixel.
struct __attribute__((packed)) EarthGeo {
  uint16_t u0;             // longitude (fraction of a turn, before spin)
  uint8_t  v;              // texture row
};
struct EarthLit {
  int8_t   diff;           // sunlight n.L * 127
  uint8_t  atmSpec;        // high nibble: blue haze toward the limb, low nibble: sun glint on water
};
const int EARTH_RMAX = 59;                       // > silhouette radius in pixels
const int MAX_EARTH_PX = 10700, MAX_EARTH_HALF = MAX_EARTH_PX / 2;
static EarthGeo earthGeo[MAX_EARTH_HALF];
static EarthLit earthLit[MAX_EARTH_PX];
static int16_t  earthHalfStart[2 * EARTH_RMAX + 1];
static int8_t   earthN[2 * EARTH_RMAX + 1];
static float    earthSilR = 0.0f;                // silhouette radius in pixels
struct HaloPx { int8_t dx, dy; uint8_t a; };     // thin blue atmosphere glow outside the limb
const int MAX_HALO_PX = 1600;
static HaloPx haloPx[MAX_HALO_PX];
static int    numHaloPx = 0;

struct Star { float x, y, b; };
static Star stars[NUM_STARS];

static uint8_t  glowMap[W * H];      // precomputed soft glow behind the black hole (this board's half)
static float    glowBuiltFor = 0.0f; // which side the glow map was built for (+1 / -1)
static uint16_t glowLut[256];

// ---------- radio link ----------
struct __attribute__((packed)) Packet {
  uint32_t magic;
  uint8_t  version;
  uint8_t  swapCount;
  uint16_t seq;
  uint32_t clockMs;      // sender's shared clock
  uint8_t  prox;         // sender's proximity 0..255
};
const uint32_t MAGIC = 0x50535154;   // "TQSP"
const uint8_t  PROTO = 2;
const uint8_t  BCAST[6] = {0xFF, 0xFF, 0xFF, 0xFF, 0xFF, 0xFF};

static portMUX_TYPE linkMux = portMUX_INITIALIZER_UNLOCKED;
const int RSSI_BUF = 8;
static volatile int8_t   rssiBuf[RSSI_BUF];
static volatile uint32_t rssiCount = 0;
static volatile uint32_t lastRxMs = 0;
static volatile uint8_t  peerSwap = 0;
static volatile uint8_t  peerProxByte = 0;
static volatile uint32_t peerClockMs = 0;
static volatile uint32_t peerClockRxMs = 0;
static uint8_t peerMac[6] = {0};
static uint8_t myMac[6]   = {0};

static uint8_t  mySwap = 0;
static uint16_t txSeq = 0;
static Preferences prefs;
static int32_t  clockOffset = 0;     // shared clock = millis() + clockOffset
static bool     clockSynced = false;

// ---------- animation state ----------
static float rssiFiltered = -100.0f;
static float prox = 0.0f;            // this board's own proximity estimate, 0..1
static float sceneP = 0.0f;          // proximity used for drawing (averaged with the peer's)
static float sideSmooth = 1.0f;      // +1 = I'm the LEFT board (peer on my right), -1 = right board
static float spinExtra = 0.0f;       // extra sphere spin that builds up while close
static bool  showDebug = false;

// =================================== helpers ===================================

static inline float clampf(float v, float lo, float hi) { return v < lo ? lo : (v > hi ? hi : v); }

static inline float smoothstepf(float a, float b, float x) {
  float t = clampf((x - a) / (b - a), 0.0f, 1.0f);
  return t * t * (3.0f - 2.0f * t);
}

static inline uint16_t rgb565(uint8_t r, uint8_t g, uint8_t b) {
  uint16_t c = ((r & 0xF8) << 8) | ((g & 0xFC) << 3) | (b >> 3);
  return (uint16_t)((c << 8) | (c >> 8));  // byte-swap for the SPI push
}

static inline uint16_t pack(float r, float g, float b) {
  return rgb565((uint8_t)(clampf(r, 0, 1) * 255), (uint8_t)(clampf(g, 0, 1) * 255), (uint8_t)(clampf(b, 0, 1) * 255));
}

// fraction of a turn (any real number) -> 0..65535
static inline uint16_t turn16(float f) { f -= floorf(f); return (uint16_t)(f * 65536.0f); }

// One Earth sample, lit. diff = n.L (sunlight), atm = limb haze 0..1, spec = sun glint 0..1.
static void earthShade(uint8_t land, uint8_t cloud, float diff, float atm, float spec,
                       float &r, float &g, float &b) {
  const uint8_t cls = land & 15;
  const float *p = EARTH_PAL[cls];
  float a = cloud * (0.85f / 255.0f);
  r = p[0] + (0.94f - p[0]) * a;
  g = p[1] + (0.96f - p[1]) * a;
  b = p[2] + (1.00f - p[2]) * a;
  float day = clampf(diff * 1.25f + 0.08f, 0.0f, 1.0f);       // soft day/night line
  float lit = 0.07f + 0.93f * day;
  r *= lit; g *= lit; b *= lit;
  if (cls <= 2) {                                             // sun glint on open water
    float s = spec * (1.0f - a) * 0.45f;
    r += s; g += s * 0.95f; b += s * 0.85f;
  }
  if (land & 0x80) {                                          // city lights on the night side
    float nite = (1.0f - smoothstepf(0.0f, 0.2f, diff + 0.05f)) * (1.0f - a) * 0.85f;
    r += nite; g += nite * 0.70f; b += nite * 0.30f;
  }
  float h = atm * (0.25f + 0.75f * day);                      // blue air toward the limb
  r += 0.18f * h; g += 0.38f * h; b += 0.85f * h;
}

static inline void sunVectors(float &lx, float &ly, float &lz, float &hx, float &hy, float &hz) {
  float n = sqrtf(SUN_X * SUN_X + SUN_Y * SUN_Y + SUN_Z * SUN_Z);
  lx = SUN_X / n; ly = SUN_Y / n; lz = SUN_Z / n;
  hx = lx; hy = ly; hz = lz + 1.0f;                           // half vector, viewer along +z
  n = sqrtf(hx * hx + hy * hy + hz * hz);
  hx /= n; hy /= n; hz /= n;
}

static inline float pow64(float x) { x *= x; x *= x; x *= x; x *= x; x *= x; x *= x; return x; }

// Disk palette: 0 = inner edge (white-hot) -> 1 = outer edge (deep orange)
static void diskColor(float k, float &r, float &g, float &b) {
  k = clampf(k, 0.0f, 1.0f);
  if (k < 0.30f)      { float t = k / 0.30f;            r = 1.0f;               g = 1.0f - 0.08f * t;  b = 1.0f - 0.30f * t; }
  else if (k < 0.65f) { float t = (k - 0.30f) / 0.35f;  r = 1.0f;               g = 0.92f - 0.32f * t; b = 0.70f - 0.45f * t; }
  else                { float t = (k - 0.65f) / 0.35f;  r = 1.0f - 0.25f * t;   g = 0.60f - 0.32f * t; b = 0.25f - 0.18f * t; }
}

static inline void plot(int x, int y, uint16_t c) {
  if ((unsigned)x >= (unsigned)W || (unsigned)y >= (unsigned)H) return;
#if FLIP_SCREEN
  x = W - 1 - x; y = H - 1 - y;
#endif
  fb[y * W + x] = c;
}

static inline void fillRect(int x, int y, int w, int h, uint16_t c) {
  for (int j = 0; j < h; j++)
    for (int i = 0; i < w; i++) plot(x + i, y + j, c);
}

static void fillCircle(float cx, float cy, float rad, uint16_t c) {
  int r = (int)ceilf(rad);
  float r2 = rad * rad;
  int x0 = (int)floorf(cx), y0 = (int)floorf(cy);
  for (int y = -r; y <= r; y++) {
    int yy = y0 + y;
    if (yy < 0 || yy >= H) continue;
    for (int x = -r; x <= r; x++) {
      int xx = x0 + x;
      if (xx < 0 || xx >= W) continue;
      float dx = xx + 0.5f - cx, dy = yy + 0.5f - cy;
      if (dx * dx + dy * dy <= r2) plot(xx, yy, c);
    }
  }
}

static float hash01(uint32_t n) {                      // cheap repeatable pseudo-random 0..1
  n = (n ^ 61) ^ (n >> 16); n *= 9; n ^= n >> 4; n *= 0x27d4eb2d; n ^= n >> 15;
  return (n & 0xFFFFFF) / 16777216.0f;
}


// 3x5 pixel font for the debug overlay: digits, '-', 'L', 'R'
static const uint8_t FONT3x5[][5] = {
  {7,5,5,5,7}, {2,6,2,2,7}, {7,1,7,4,7}, {7,1,7,1,7}, {5,5,7,1,1},
  {7,4,7,1,7}, {7,4,7,5,7}, {7,1,1,1,1}, {7,5,7,5,7}, {7,5,7,1,7},
  {0,0,7,0,0}, {4,4,4,4,7}, {6,5,6,5,5},
};
static void drawChar(int x, int y, char ch, uint16_t c, int s) {
  int idx;
  if (ch >= '0' && ch <= '9') idx = ch - '0';
  else if (ch == '-') idx = 10;
  else if (ch == 'L') idx = 11;
  else if (ch == 'R') idx = 12;
  else return;
  for (int row = 0; row < 5; row++)
    for (int col = 0; col < 3; col++)
      if (FONT3x5[idx][row] & (4 >> col)) fillRect(x + col * s, y + row * s, s, s, c);
}
static void drawText(int x, int y, const char *str, uint16_t c, int s) {
  for (; *str; str++, x += 4 * s) drawChar(x, y, *str, c, s);
}

// ================================= radio link ==================================

static void onRecv(const esp_now_recv_info_t *info, const uint8_t *data, int len) {
  if (len != (int)sizeof(Packet)) return;
  Packet p;
  memcpy(&p, data, sizeof(p));
  if (p.magic != MAGIC || p.version != PROTO) return;
  uint32_t now = millis();
  portENTER_CRITICAL(&linkMux);
  memcpy(peerMac, info->src_addr, 6);
  rssiBuf[rssiCount % RSSI_BUF] = (int8_t)info->rx_ctrl->rssi;
  rssiCount = rssiCount + 1;
  lastRxMs = now;
  peerSwap = p.swapCount;
  peerProxByte = p.prox;
  peerClockMs = p.clockMs;
  peerClockRxMs = now;
  portEXIT_CRITICAL(&linkMux);
}

static void radioBegin() {
  WiFi.mode(WIFI_STA);
  WiFi.disconnect();
  WiFi.setTxPower(TX_POWER);
  esp_wifi_set_promiscuous(true);
  esp_wifi_set_channel(ESPNOW_CHANNEL, WIFI_SECOND_CHAN_NONE);
  esp_wifi_set_promiscuous(false);
  esp_wifi_get_mac(WIFI_IF_STA, myMac);

  if (esp_now_init() != ESP_OK) {
    Serial.println("ESP-NOW init failed");
    return;
  }
  esp_now_register_recv_cb(onRecv);

  esp_now_peer_info_t peer = {};
  memcpy(peer.peer_addr, BCAST, 6);
  peer.channel = 0;                  // 0 = current channel
  peer.ifidx = WIFI_IF_STA;
  peer.encrypt = false;
  esp_now_add_peer(&peer);
}

static inline uint32_t sharedMillis() { return millis() + (uint32_t)clockOffset; }

static void radioSend() {
  Packet p;
  p.magic = MAGIC;
  p.version = PROTO;
  p.swapCount = mySwap;
  p.seq = txSeq++;
  p.clockMs = sharedMillis();
  p.prox = (uint8_t)(clampf(prox, 0, 1) * 255.0f);
  esp_now_send(BCAST, (const uint8_t *)&p, sizeof(p));
}

// Median of the most recent RSSI samples (kills single-packet spikes)
static float rssiMedian() {
  int8_t s[RSSI_BUF];
  int n;
  portENTER_CRITICAL(&linkMux);
  n = rssiCount < RSSI_BUF ? (int)rssiCount : RSSI_BUF;
  for (int i = 0; i < n; i++) s[i] = rssiBuf[i];
  portEXIT_CRITICAL(&linkMux);
  if (n == 0) return -100;
  for (int i = 1; i < n; i++) {      // insertion sort, n <= 8
    int8_t v = s[i]; int j = i - 1;
    while (j >= 0 && s[j] > v) { s[j + 1] = s[j]; j--; }
    s[j + 1] = v;
  }
  return s[n / 2];
}

// ================================== scene =====================================

static void buildScene() {
  numDots = 0;
  for (int r = 0; r < RINGS && numDots < MAX_DOTS; r++) {
    float lat = PI * ((r + 0.5f) / RINGS) - HALF_PI;     // -90..90 deg
    float cl = cosf(lat), sl = sinf(lat);
    int count = max(1, (int)roundf(2.0f * RINGS * cl));
    for (int k = 0; k < count && numDots < MAX_DOTS; k++) {
      float lon = TWO_PI * (k + 0.5f * (r & 1)) / count;
      Dot &d = dots[numDots];
      d.x = cl * cosf(lon);
      d.y = sl;
      d.z = cl * sinf(lon);
      // where this dot sits on the Earth map (same mapping as the solid Earth below)
      d.tu = turn16(0.5f - lon / TWO_PI);
      d.tv = (uint8_t)clampf((0.5f - lat / PI) * EARTH_TH, 0, EARTH_TH - 1);
      d.land = EARTH_LAND[d.tv][d.tu >> 8];
      // Disk slot comes from where the dot sits on the sphere (not a random hash), so
      // neighbouring dots stay neighbours while they fall in: the equator feeds the hot
      // inner edge, the poles spread out to the cool outer rim. Both boards compute the
      // exact same slots, so the disk matches across the gap.
      float u = powf(1.0f - cl, 0.55f) + 0.05f * (hash01(numDots * 2 + 1) - 0.5f);
      d.rdn = DISK_INNER + (DISK_OUTER - DISK_INNER) * clampf(u, 0.0f, 1.0f);
      d.ang = lon;
      d.omega = 1.3f / (d.rdn * sqrtf(d.rdn));           // inner orbits faster (Kepler-ish)
      d.jitter = (sl >= 0 ? 0.025f : -0.025f) + (hash01(numDots * 2 + 7) - 0.5f) * 0.05f;
      numDots++;
    }
  }
  for (int i = 0; i < NUM_STARS; i++) {
    stars[i].x = hash01(i * 3 + 101) * W;
    stars[i].y = hash01(i * 3 + 202) * H;
    stars[i].b = 0.15f + 0.45f * hash01(i * 3 + 303);
  }
}

// Ray-trace the resting globe once: same camera as the dot projection (persp = D / (D - z)),
// same axial tilt. Stores where each covered pixel hits the globe and how it's lit.
static void buildEarth() {
  float lx, ly, lz, hx, hy, hz;
  sunVectors(lx, ly, lz, hx, hy, hz);
  const float R = SPHERE_RADIUS, D = CAM_DIST;
  const float cT = cosf(0.42f), sT = sinf(0.42f);
  const float rimSpan = 1.0f - 1.0f / D;                     // nz at the silhouette is 1/D
  earthSilR = R * sqrtf(D * D / (D * D - 1.0f));
  int nHalf = 0, nLit = 0;
  for (int row = 0; row < 2 * EARTH_RMAX + 1; row++) {
    const int y = row - EARTH_RMAX;
    const float Y = -(y + 0.5f) / R;                         // up
    earthHalfStart[row] = (int16_t)nHalf;
    earthN[row] = 0;
    // right half: where each pixel lands on the globe
    for (int x = 0; x <= EARTH_RMAX; x++) {
      const float X = (x + 0.5f) / R;
      const float a = X * X + Y * Y + D * D;
      const float disc = D * D * D * D - a * (D * D - 1.0f);
      if (disc < 0.0f || nHalf >= MAX_EARTH_HALF || nLit + 2 * (x + 1) > MAX_EARTH_PX) break;
      const float tt = (D * D - sqrtf(disc)) / a;            // nearest hit along the ray
      const float nx = tt * X, ny = tt * Y, nz = D * (1.0f - tt);
      // undo the tilt, then longitude/latitude on the (unspun) globe
      const float by = ny * cT + nz * sT;
      const float z1 = -ny * sT + nz * cT;
      const float lat = asinf(clampf(by, -1.0f, 1.0f));
      const float lon0 = atan2f(z1, nx);
      EarthGeo &g = earthGeo[nHalf++];
      g.u0 = turn16(-lon0 / TWO_PI);
      g.v = (uint8_t)clampf((0.5f - lat / PI) * EARTH_TH, 0, EARTH_TH - 1);
      earthN[row] = (int8_t)(x + 1);
    }
    // whole row: lighting
    for (int x = -earthN[row]; x < earthN[row]; x++) {
      const float X = (x + 0.5f) / R;
      const float a = X * X + Y * Y + D * D;
      const float disc = fmaxf(D * D * D * D - a * (D * D - 1.0f), 0.0f);
      const float tt = (D * D - sqrtf(disc)) / a;
      const float nx = tt * X, ny = tt * Y, nz = D * (1.0f - tt);
      const float rim = clampf((1.0f - nz) / rimSpan, 0.0f, 1.0f);
      const float atm = rim * rim * rim * 0.8f;
      const float spec = pow64(fmaxf(nx * hx + ny * hy + nz * hz, 0.0f));
      EarthLit &l = earthLit[nLit++];
      l.diff = (int8_t)(clampf(nx * lx + ny * ly + nz * lz, -1.0f, 1.0f) * 127.0f);
      l.atmSpec = (uint8_t)(((int)roundf(atm * 15.0f) << 4) | (int)roundf(spec * 15.0f));
    }
  }
  // thin glow ring just outside the limb, brighter on the sunny side
  const float hw = 3.5f;
  const int hr = (int)ceilf(earthSilR + hw);
  numHaloPx = 0;
  for (int y = -hr; y <= hr; y++) {
    for (int x = -hr; x <= hr; x++) {
      float X = x + 0.5f, Y = -(y + 0.5f);
      float d = sqrtf(X * X + Y * Y);
      if (d <= earthSilR || d >= earthSilR + hw || numHaloPx >= MAX_HALO_PX) continue;
      float tt = (d - earthSilR) / hw;
      float lf = clampf(0.5f + 0.8f * (X / d * lx + Y / d * ly), 0.15f, 1.0f);
      HaloPx &h = haloPx[numHaloPx++];
      h.dx = (int8_t)x; h.dy = (int8_t)y;
      h.a = (uint8_t)((1.0f - tt) * (1.0f - tt) * lf * 0.6f * 255.0f);
    }
  }
}

// Draw the solid Earth centred on (cx, cy). spin = the globe's turn angle, cloudTurn = cloud
// drift (fraction of a turn). dis 0..1 breaks it into nothing, side facing the other board first.
static void drawEarth(int cx, int cy, float spin, float cloudTurn, float sphereSign, float dis, float bright) {
  const uint16_t uRot = turn16(0.5f - spin / TWO_PI);
  const uint16_t cRot = turn16(cloudTurn);
  int i = 0;
  for (int row = 0; row < 2 * EARTH_RMAX + 1; row++) {
    const int y = cy + row - EARTH_RMAX;
    const int n = earthN[row];
    const EarthGeo *half = &earthGeo[earthHalfStart[row]];
    for (int x = -n; x < n; x++, i++) {
      if (dis > 0.0f) {
        float f = clampf(x / earthSilR, -1.0f, 1.0f) * sphereSign;   // +1 = facing the other board
        float key = 0.55f * (1.0f - f) * 0.5f + 0.45f * hash01(i * 7 + 3);
        if (key < dis) continue;
      }
      const EarthGeo &g = half[x >= 0 ? x : -x - 1];
      const uint16_t u0 = x >= 0 ? g.u0 : (uint16_t)(32768u - g.u0);   // mirror: lon -> pi - lon
      const uint16_t u = u0 + uRot;
      const uint8_t land  = EARTH_LAND[g.v][u >> 8];
      const uint8_t cloud = EARTH_CLOUD[g.v][(uint16_t)(u + cRot) >> 8];
      const EarthLit &l = earthLit[i];
      float r, gg, b;
      earthShade(land, cloud, l.diff * (1.0f / 127.0f), (l.atmSpec >> 4) * (1.0f / 15.0f),
                 (l.atmSpec & 15) * (1.0f / 15.0f), r, gg, b);
      plot(cx + x, y, pack(r * bright, gg * bright, b * bright));
    }
  }
  const float ha = 1.0f - dis;
  if (ha <= 0.0f) return;
  for (int k = 0; k < numHaloPx; k++) {
    float a = haloPx[k].a * (1.0f / 255.0f) * ha;
    plot(cx + haloPx[k].dx, cy + haloPx[k].dy, pack(0.30f * a, 0.55f * a, 1.0f * a));
  }
}

// Hole centre in THIS board's screen coordinates. The left board's screen spans virtual
// x = 0..127, then GAP_PX of bezel, then the right board's screen. The hole sits in the gap.
static inline float holeCenterX(float sideSign) { return W * 0.5f + sideSign * (W * 0.5f + GAP_PX * 0.5f); }

static void buildGlow(float sideSign) {
  float hcx = holeCenterX(sideSign), hcy = H * 0.5f;
  float ct = cosf(DISK_TILT), st = sinf(DISK_TILT);
  for (int y = 0; y < H; y++) {
    for (int x = 0; x < W; x++) {
      float dx = x + 0.5f - hcx, dy = hcy - (y + 0.5f);  // dy up
      float ux =  dx * ct + dy * st;                     // un-tilt so the band follows the disk
      float uy = -dx * st + dy * ct;
      float r = sqrtf(dx * dx + dy * dy);
      float g = 0.0f;
      if (r > HOLE_RADIUS) {
        float band = expf(-fabsf(uy) / (5.0f + 0.07f * fabsf(ux))) * expf(-fabsf(ux) / 150.0f);
        float ring = expf(-fabsf(r - HOLE_RADIUS * 1.22f) / 10.0f);
        float haze = expf(-(r - HOLE_RADIUS) / 60.0f);
        g = 0.55f * band + 0.40f * ring + 0.25f * haze;
      }
      glowMap[y * W + x] = (uint8_t)(clampf(g, 0, 1) * 255.0f);
    }
  }
  glowBuiltFor = sideSign;
}

// Stages (P = shared proximity):
//   P = 0               -> solid pixel Earth, slowly turning (one turn per SPIN_PERIOD_S)
//   P up to MERGE_START -> the Earth breaks up into big dots (side facing the gap first),
//                          then both stretch toward the gap until their tips touch
//   MERGE_START..FULL   -> the side facing the gap is torn off first; every dot spirals
//                          around the hole (always in the disk's spin direction) and settles
//                          into its slot in ONE accretion disk spanning both screens.
//                          The event horizon grows in the gap between the boards.
static void renderScene(float t, float tShared, float dt) {
  const float P = sceneP;
  const float sgn = sideSmooth >= 0 ? 1.0f : -1.0f;          // +1: I'm the left board
  // linear here: each dot eases on its own below, so the morph is spread evenly over the dBm range
  const float m = clampf((P - MERGE_START) / (MERGE_FULL - MERGE_START), 0.0f, 1.0f);   // 0 = spheres, 1 = black hole
  const float q = clampf(P / MERGE_START, 0.0f, 1.0f);       // progress through the reach phase
  const float dis = smoothstepf(0.0f, 0.45f, q);             // solid Earth breaks up into dots first...
  const float reachAmt = clampf((q - 0.15f) / 0.85f, 0.0f, 1.0f) * (1.0f - m);   // ...then they stretch

  // --- background: soft warm glow (only while the hole exists) ---
  if (glowBuiltFor != sgn) buildGlow(sgn);
  if (m > 0.01f) {
    for (int v = 0; v < 256; v++) {
      float g = (v / 255.0f) * m * 0.42f;
      glowLut[v] = pack(g, g * 0.60f, g * 0.30f);
    }
#if FLIP_SCREEN
    for (int i = 0; i < W * H; i++) fb[W * H - 1 - i] = glowLut[glowMap[i]];
#else
    for (int i = 0; i < W * H; i++) fb[i] = glowLut[glowMap[i]];
#endif
  } else {
    memset(fb, 0, sizeof(fb));
  }

  const float hcx = holeCenterX(sgn);
  const float hcy = H * 0.5f;
  const float hR  = HOLE_RADIUS * smoothstepf(0.0f, 1.0f, m);   // horizon grows in, full size at MERGE_FULL_DBM
  const float Rh  = HOLE_RADIUS;                                 // disk scale (fixed)
  const float R   = SPHERE_RADIUS;

  // Spin comes from the shared clock so both boards draw the same Earths; the extra spin
  // while close is integrated locally (both boards see ~the same P, so they agree).
  spinExtra = fmodf(spinExtra + dt * 0.8f * P, TWO_PI);
  const float rotY = TWO_PI * fmodf(tShared, SPIN_PERIOD_S) / SPIN_PERIOD_S + spinExtra;
  const float cloudTurn = fmodf(tShared, CLOUD_PERIOD_S) / CLOUD_PERIOD_S;
  const uint16_t cRot = turn16(cloudTurn);
  const float tilt = 0.42f;                           // ~ Earth's axial tilt, north pole toward you
  const float cT = cosf(tilt), sT = sinf(tilt);
  const float sE = sinf(0.17f);                       // we see the disk almost edge-on
  const float cD = cosf(DISK_TILT), sD = sinf(DISK_TILT);
  const float bright = 1.0f + 0.15f * P;
  float lx, ly, lz, hx, hy, hz;
  sunVectors(lx, ly, lz, hx, hy, hz);

  // --- stars, pushed outward around the hole (gravitational lensing) ---
  for (int i = 0; i < NUM_STARS; i++) {
    float dx = stars[i].x - hcx, dy = stars[i].y - hcy;
    float d2 = dx * dx + dy * dy + 1.0f;
    float push = 1.0f + m * (hR * hR * 1.6f) / d2;
    float twinkle = 0.75f + 0.25f * sinf(t * 2.0f + i);
    float v = stars[i].b * twinkle * (0.5f + 0.3f * m);
    float sx = hcx + dx * push, sy = hcy + dy * push;
    float rx = sx - hcx, ry = sy - hcy;
    if (m > 0.01f && rx * rx + ry * ry < hR * hR * 1.3f) continue;   // swallowed
    plot((int)sx, (int)sy, pack(v, v, v));
  }

  // --- the solid Earth on my own screen, until it has broken up into dots ---
  // (the right-hand Earth is turned half a turn, so the two boards show different sides)
  if (dis < 1.0f) {
    const float mySpin = rotY + (sgn > 0 ? 0.0f : PI);
    const int ex = (int)roundf(W * 0.5f + sgn * 9.0f * reachAmt);
    drawEarth(ex, (int)(H * 0.5f), mySpin, cloudTurn, sgn, dis, bright);
  }

  // pass 0: far side (+ lensed halo), pass 1: event horizon, pass 2: near side
  for (int pass = 0; pass < 3; pass++) {
    if (pass == 1) {
      if (m > 0.01f) {
        fillCircle(hcx, hcy, hR * 1.05f, pack(0.95f * m, 0.90f * m, 0.80f * m)); // thin bright rim
        fillCircle(hcx, hcy, hR, 0);                                         // the hole: pure black
      }
      continue;
    }
    const bool wantFront = (pass == 2);

    for (int sphere = 1; sphere >= -1; sphere -= 2) {           // +1 = left sphere, -1 = right sphere
      const bool  mine   = (sphere == (int)sgn);
      const float cx     = W * 0.5f + (mine ? 0.0f : sgn * (W + GAP_PX)) + sphere * 9.0f * reachAmt;
      const float cy     = H * 0.5f;
      const float angOff = sphere > 0 ? 0.0f : PI;              // the two spheres feed interleaved disk slots
      if (!mine && m <= 0.0f) {                                 // other sphere can't reach my screen yet
        float extent = R * (1.0f + REACH_AMP * reachAmt) * 1.42f;
        if (cx - extent > W || cx + extent < 0) continue;
      }
      const bool solidCovers = mine && dis <= 0.0f;            // the solid Earth already shows these
      if (solidCovers && m <= 0.0f) continue;                   // at rest: nothing to add, skip the loop
      const float spin = rotY + (sphere > 0 ? 0.0f : PI);
      const float cR = cosf(spin), sR = sinf(spin);

      for (int i = 0; i < numDots; i++) {
        const Dot &d = dots[i];

        // ---- sphere: rotate around Y, tilt around X, stretch toward the other sphere ----
        float x1 = d.x * cR + d.z * sR;
        float z1 = -d.x * sR + d.z * cR;
        float sy = d.y * cT - z1 * sT;
        float sz = d.y * sT + z1 * cT;
        float sx = x1;
        const float nx = sx, ny = sy, nz = sz;         // surface normal before stretching, for lighting
        float dp = sx * sphere;                        // +1 = facing the other sphere
        float reach = dp > 0 ? dp * dp * dp : 0.0f;
        float back  = dp < 0 ? -dp : 0.0f;
        float r = 1.0f + reachAmt * (REACH_AMP * reach - 0.10f * back);
        float pinch = 1.0f - 0.30f * reachAmt * reach;
        sx *= r; sy *= r * pinch; sz *= r * pinch;
        float persp = 3.4f / (3.4f - sz);
        float spx = cx + sx * R * persp;
        float spy = cy - sy * R * persp;
        bool  sFront = sz >= 0;

        // per-dot merge progress: the side facing the gap is torn off first
        float delay = (1.0f - clampf(dp, -1, 1)) * 0.5f;     // 0 facing gap .. 1 facing away
        float mi = smoothstepf(0.0f, 1.0f, m * 1.7f - delay * 0.7f);

        // Earth colour of this dot, lit the same way as the solid globe
        float er = 0, eg = 0, eb = 0;
        auto earthColour = [&]() {
          float diff = nx * lx + ny * ly + nz * lz;
          float rim = clampf((1.0f - nz) / (1.0f - 1.0f / CAM_DIST), 0.0f, 1.0f);
          float spec = pow64(fmaxf(nx * hx + ny * hy + nz * hz, 0.0f));
          uint8_t cloud = EARTH_CLOUD[d.tv][(uint16_t)(d.tu + cRot) >> 8];
          earthShade(d.land, cloud, diff, rim * rim * rim * 0.8f, spec, er, eg, eb);
          er *= bright; eg *= bright; eb *= bright;
        };

        if (mi <= 0.0f) {                              // still part of the globe: cheap path
          if (!sFront || !wantFront || solidCovers) continue;   // the globe is opaque: no far side
          if (spx < -2 || spx > W + 1 || spy < -2 || spy > H + 1) continue;
          earthColour();
          fillRect((int)spx - 1, (int)spy - 1, 3, 3, pack(er, eg, eb));   // big dots: a mosaic globe
          continue;
        }

        // ---- shared disk slot (identical on both boards, driven by the shared clock) ----
        float th = d.ang + angOff - tShared * d.omega;
        float ct = cosf(th), st = sinf(th);
        float rpx = d.rdn * Rh;
        float dzp = -rpx * st;                         // > 0 = far side (behind the hole)
        bool  dFront = dzp < 0;
        bool  front  = mi < 0.5f ? sFront : dFront;
        bool  drawMain = (front == wantFront);
        bool  drawLens = (pass == 0 && !dFront && mi > 0.05f && hR > 2.0f);
        if (!drawMain && !drawLens) continue;

        float ux = rpx * ct;
        float uy = dzp * sE + d.jitter * Rh;           // height on screen (up)
        float vx = ux * cD + uy * sD;                  // tilt the whole disk slightly
        float vy = -ux * sD + uy * cD;
        float dpx = hcx + vx, dpy = hcy - vy;

        float k = (d.rdn - DISK_INNER) / (DISK_OUTER - DISK_INNER);   // 0 inner edge .. 1 outer edge
        float hr, hg, hb;
        diskColor(k, hr, hg, hb);
        float doppler = 1.0f - 0.45f * ct;             // side moving toward you is brighter...
        float red = ct > 0 ? ct : 0.0f;                // ...the receding side goes dim AND red
        hg *= 1.0f - 0.35f * red;
        hb *= 1.0f - 0.60f * red;

        if (drawMain) {
          // ---- tidal stream: spiral around the hole from the sphere slot to the disk slot ----
          float px, py;
          if (mi >= 1.0f) { px = dpx; py = dpy; }
          else {
            float ax = spx - hcx, ay = hcy - spy;      // y up
            float bx = dpx - hcx, by = hcy - dpy;
            float ra = sqrtf(ax * ax + ay * ay), aa = atan2f(ay, ax);
            float rb = sqrtf(bx * bx + by * by), ab = atan2f(by, bx);
            float dth = ab - aa;
            while (dth > 0.0f) dth -= TWO_PI;          // always sweep in the disk's spin direction
            while (dth <= -TWO_PI) dth += TWO_PI;
            float rr = ra + (rb - ra) * mi;
            rr *= 1.0f - STREAM_DIP * sinf(PI * mi);
            float rmin = hR * 1.08f;
            if (rr < rmin) rr = rmin;
            float a = aa + dth * mi;
            px = hcx + rr * cosf(a);
            py = hcy - rr * sinf(a);
          }

          if (px >= -2 && px <= W + 1 && py >= -2 && py <= H + 1) {
            earthColour();
            if (!sFront) {                             // far-side dots fade in as they're pulled off
              float f = smoothstepf(0.0f, 0.3f, mi);
              er *= f; eg *= f; eb *= f;
            }
            float db = (dFront ? 1.0f : 0.80f) * (1.0f - 0.55f * k) * doppler;
            float heat = 1.0f + 0.3f * sinf(PI * mi);  // the stream runs hot
            float cr = (er + (hr * db - er) * mi) * heat;
            float cg = (eg + (hg * db - eg) * mi) * heat;
            float cb = (eb + (hb * db - eb) * mi) * heat;

            bool hidden = false;                       // far side behind the horizon
            if (!front && mi > 0.5f) {
              float ex = px - hcx, ey = py - hcy;
              hidden = ex * ex + ey * ey < hR * hR;
            }
            if (!hidden) {
              uint16_t c = pack(cr, cg, cb);
              if (front || mi > 0.5f) fillRect((int)px, (int)py, 2, 2, c);
              else                    plot((int)px, (int)py, c);
            }
          }
        }

        if (drawLens) {
          // lensed image of the FAR side of the disk, bent up over the top of the hole
          float far = dzp / rpx;                       // 0..1, 1 = directly behind
          float lb = smoothstepf(0.4f, 1.0f, mi) * 0.90f * (1.0f - 0.5f * k) * doppler;
          float lr = hR * (1.10f + 0.40f * k);
          float ax = ct * lr, ay = far * lr * 1.04f;
          float lx = hcx + ax * cD + ay * sD, ly = hcy - (-ax * sD + ay * cD);
          fillRect((int)lx, (int)ly, 2, 1, pack(hr * lb, hg * lb, hb * lb));
          // fainter secondary image hugging the bottom of the hole
          float lr2 = hR * (1.06f + 0.12f * k);
          float bx = ct * lr2, by = -far * lr2;
          float l2x = hcx + bx * cD + by * sD, l2y = hcy - (-bx * sD + by * cD);
          float lb2 = lb * 0.40f;
          plot((int)l2x, (int)l2y, pack(hr * lb2, hg * lb2, hb * lb2));
        }
      }
    }
  }
}

static void renderDebug(bool linked, float rssi) {
  uint16_t white = rgb565(255, 255, 255);
  uint16_t dim   = rgb565(60, 60, 60);
  char buf[8];
  if (linked) snprintf(buf, sizeof(buf), "%d", (int)roundf(rssi));
  else        snprintf(buf, sizeof(buf), "---");
  drawText(2, 2, buf, white, 2);
  drawText(W - 8, 2, sideSmooth > 0 ? "L" : "R", white, 2);   // which board am I
  fillRect(W - 14, 4, 4, 4, linked ? rgb565(0, 255, 0) : rgb565(255, 0, 0));
  fillRect(2, H - 6, W - 4, 4, dim);
  fillRect(2, H - 6, (int)((W - 4) * sceneP), 4, white);
  // orange ticks above the bar: where the merge starts and where the hole is complete
  uint16_t tick = rgb565(255, 140, 0);
  fillRect(2 + (int)((W - 5) * MERGE_START), H - 9, 1, 3, tick);
  fillRect(2 + (int)((W - 5) * MERGE_FULL),  H - 9, 1, 3, tick);
}

static void bootTest() {
  uint16_t red = rgb565(255, 0, 0), green = rgb565(0, 255, 0), blue = rgb565(0, 0, 255);
  uint16_t white = rgb565(255, 255, 255);
  fillRect(0, 0, W, H / 3, red);
  fillRect(0, H / 3, W, H / 3, green);
  fillRect(0, 2 * H / 3, W, H - 2 * H / 3, blue);
  for (int i = 0; i < W; i++) { plot(i, 0, white); plot(i, H - 1, white); }
  for (int j = 0; j < H; j++) { plot(0, j, white); plot(W - 1, j, white); }
  tqt::pushFrame(fb);
  delay(1200);
}

// =================================== buttons ===================================

struct Button {
  int pin; bool last = true; uint32_t t = 0;
  explicit Button(int p) : pin(p) {}
  bool pressed() {                                     // true once per press
    bool now = digitalRead(pin);
    if (now != last && millis() - t > 40) {
      t = millis(); last = now;
      return now == LOW;
    }
    return false;
  }
};
static Button btnBoot(PIN_BTN_BOOT), btnKey(PIN_BTN_KEY);

// ==================================== main =====================================

void setup() {
  Serial.begin(115200);
  pinMode(PIN_BTN_BOOT, INPUT_PULLUP);
  pinMode(PIN_BTN_KEY, INPUT_PULLUP);

  tqt::begin(PANEL_VERSION, BACKLIGHT_ON);
  bootTest();

  prefs.begin("spheres", false);
  mySwap = prefs.getUChar("swap", 0);

  radioBegin();
  buildScene();
  buildEarth();

  Serial.printf("\nProximitySpheres_SharedHole  panel=V%d  dots=%d  mac=%02X:%02X:%02X:%02X:%02X:%02X\n",
                PANEL_VERSION, numDots, myMac[0], myMac[1], myMac[2], myMac[3], myMac[4], myMac[5]);
}

void loop() {
  static uint32_t lastFrameUs = micros();
  static uint32_t lastTxMs = 0, lastLogMs = 0, lastClockRx = 0;

  uint32_t nowUs = micros();
  float dt = clampf((nowUs - lastFrameUs) * 1e-6f, 0.0f, 0.1f);
  lastFrameUs = nowUs;
  float t = millis() * 0.001f;

  if (millis() - lastTxMs >= 25) { lastTxMs = millis(); radioSend(); }

  if (btnKey.pressed()) {
    mySwap++;
    prefs.putUChar("swap", mySwap);
    Serial.println("Swapped left/right");
  }
  if (btnBoot.pressed()) showDebug = !showDebug;

  // snapshot link state
  uint32_t lastRx, pClock, pClockRx;
  uint8_t pSwap, pProx, pMac[6];
  portENTER_CRITICAL(&linkMux);
  lastRx = lastRxMs; pSwap = peerSwap; pProx = peerProxByte;
  pClock = peerClockMs; pClockRx = peerClockRxMs;
  memcpy(pMac, peerMac, 6);
  portEXIT_CRITICAL(&linkMux);

  bool linked = lastRx != 0 && (millis() - lastRx) < 800;
  bool lowerMac = memcmp(myMac, pMac, 6) < 0;     // lower MAC = clock master

  // shared clock: the lower-MAC board is the master, the other one follows it
  if (!linked) {
    clockSynced = false;
  } else if (lowerMac) {
    clockOffset = 0;
  } else if (pClockRx != lastClockRx) {
    lastClockRx = pClockRx;
    int32_t est = (int32_t)(pClock - pClockRx) + 3;    // +3 ms for air time
    if (!clockSynced || abs(est - clockOffset) > 500) { clockOffset = est; clockSynced = true; }
    else clockOffset += (est - clockOffset) / 8;
  }

  // proximity from signal strength
  float rawRssi = rssiMedian();
  float target = 0.0f;
  if (linked) {
    float a = 1.0f - expf(-dt * 6.0f);
    rssiFiltered = (rssiFiltered < -99.0f) ? rawRssi : rssiFiltered + (rawRssi - rssiFiltered) * a;
    // linear in dBm, so the MERGE_*_DBM thresholds land exactly where the overlay says
    target = clampf((rssiFiltered - RSSI_FAR) / (RSSI_NEAR - RSSI_FAR), 0.0f, 1.0f);
  } else {
    rssiFiltered = -100.0f;
  }
  prox += (target - prox) * (1.0f - expf(-dt * 4.0f));
  // both boards draw with the average of the two estimates so the halves match
  float sharedTarget = linked ? 0.5f * (prox + pProx / 255.0f) : prox;
  float nextP = sceneP + (sharedTarget - sceneP) * (1.0f - expf(-dt * 6.0f));
  // inside the merge band the hole may only grow at a fixed pace, so it builds up slowly
  if (nextP > sceneP && nextP > MERGE_START) {
    float maxUp = (MERGE_FULL - MERGE_START) / FORM_SECONDS * dt;
    nextP = fminf(nextP, fmaxf(sceneP, MERGE_START) + maxUp);
  }
  sceneP = nextP;

  // which board is on the left? Lower MAC = left; the KEY button flips both.
  bool flipped = ((mySwap + pSwap) & 1) != 0;
  float sideTarget = (lowerMac != flipped) ? 1.0f : -1.0f;
  sideSmooth += (sideTarget - sideSmooth) * (1.0f - expf(-dt * 5.0f));

  float tShared = (sharedMillis() % 3600000UL) * 0.001f;
  renderScene(t, tShared, dt);
  if (showDebug) renderDebug(linked, rssiFiltered);
  tqt::pushFrame(fb);

  if (millis() - lastLogMs > 500) {
    lastLogMs = millis();
    Serial.printf("linked=%d  rssi=%.1f  prox=%.2f  shared=%.2f  side=%s  clockOfs=%ld  fps=%.0f\n",
                  linked, rssiFiltered, prox, sceneP, sideSmooth > 0 ? "L" : "R",
                  (long)clockOffset, dt > 0 ? 1.0f / dt : 0.0f);
  }
}
